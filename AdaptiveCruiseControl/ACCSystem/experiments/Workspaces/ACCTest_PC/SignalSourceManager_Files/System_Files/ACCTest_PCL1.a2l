ASAP2_VERSION 1 41
/begin PROJECT ACCTest_PC "Generated by ETAS from Project ACCTest_PC"
/begin HEADER "" VERSION "000" PROJECT_NO ASD /end HEADER
/begin MODULE ACCTest_PC "Generated by ETAS ASCET7 from Project: ACCTest_PC"
/begin IF_DATA E_TARGET
 /begin SOURCE "Task0" 3 /* period */ 10 QP_BLOB 1 /end SOURCE
 /begin TP_BLOB /* programm id */ 881740918 /* target id */ 7 0 2 0 /end TP_BLOB
/end IF_DATA
/begin MOD_PAR "" VERSION "000" ADDR_EPK 0x0 EPK "" SUPPLIER "ETAS GmbH" CUSTOMER "xxx" CUSTOMER_NO "000" USER "xxx" PHONE_NO "000" ECU "PC" CPU_TYPE "PCx86" NO_OF_INTERFACES 1 /end MOD_PAR
/begin MOD_COMMON "Common definitions" BYTE_ORDER MSB_LAST ALIGNMENT_BYTE 1 ALIGNMENT_WORD 2 ALIGNMENT_LONG 4 ALIGNMENT_FLOAT32_IEEE 4 ALIGNMENT_FLOAT64_IEEE 8 /end MOD_COMMON
/begin MEASUREMENT VehicleModel.VehicelDynamicModel.Vehicle0.velocity "" FLOAT32_IEEE esdl_ident 1 100.0 -3.4028234663852886E+38 3.4028234663852886E+38 ECU_ADDRESS 0x0 /end MEASUREMENT
/begin CHARACTERISTIC VehicleModel.VehicelDynamicModel.Vehicle0.A "" VALUE 0x0 STANDARD_VALUE_R32 0.0 esdl_ident -3.4028234663852886E+38 3.4028234663852886E+38 /end CHARACTERISTIC
/begin CHARACTERISTIC VehicleModel.VehicelDynamicModel.Vehicle0.cw "" VALUE 0x0 STANDARD_VALUE_R32 0.0 esdl_ident -3.4028234663852886E+38 3.4028234663852886E+38 /end CHARACTERISTIC
/begin CHARACTERISTIC VehicleModel.VehicelDynamicModel.Vehicle0.vehicle_mass "" VALUE 0x0 STANDARD_VALUE_R32 0.0 esdl_ident -3.4028234663852886E+38 3.4028234663852886E+38 /end CHARACTERISTIC
/begin CHARACTERISTIC VehicleModel.VehicelDynamicModel.Vehicle0.roh "" VALUE 0x0 STANDARD_VALUE_R32 0.0 esdl_ident -3.4028234663852886E+38 3.4028234663852886E+38 /end CHARACTERISTIC
/begin MEASUREMENT VehicleModel.VehicelDynamicModel.Vehicle0.AirResistance "" FLOAT32_IEEE esdl_ident 1 100.0 -3.4028234663852886E+38 3.4028234663852886E+38 ECU_ADDRESS 0x0 /end MEASUREMENT
/begin CHARACTERISTIC VehicleModel.VehicelDynamicModel.Vehicle0.EngineForceCurve_instance "" CURVE 0x0 STANDARD_CURVE_R32R32 0.0 esdl_ident -3.4028234663852886E+38 3.4028234663852886E+38
 /begin AXIS_DESCR STD_AXIS NO_INPUT_QUANTITY esdl_ident 11 -3.4028234663852886E+38 3.4028234663852886E+38 /end AXIS_DESCR
/end CHARACTERISTIC
/begin CHARACTERISTIC VehicleModel.VehicelDynamicModel.Vehicle0.BrakeForceCurve_instance "" CURVE 0x0 STANDARD_CURVE_R32R32 0.0 esdl_ident -3.4028234663852886E+38 3.4028234663852886E+38
 /begin AXIS_DESCR STD_AXIS NO_INPUT_QUANTITY esdl_ident 11 -3.4028234663852886E+38 3.4028234663852886E+38 /end AXIS_DESCR
/end CHARACTERISTIC
/begin MEASUREMENT VehicleModel.VehicelDynamicModel.Vehicle0.EngineForce "" FLOAT32_IEEE esdl_ident 1 100.0 -3.4028234663852886E+38 3.4028234663852886E+38 ECU_ADDRESS 0x0 /end MEASUREMENT
/begin MEASUREMENT VehicleModel.VehicelDynamicModel.Vehicle0.BrakeForce "" FLOAT32_IEEE esdl_ident 1 100.0 -3.4028234663852886E+38 3.4028234663852886E+38 ECU_ADDRESS 0x0 /end MEASUREMENT
/begin MEASUREMENT VehicleModel.VehicelDynamicModel.Vehicle0.IntegratorK_instance.memory "" FLOAT32_IEEE esdl_ident 1 100.0 -3.4028234663852886E+38 3.4028234663852886E+38 ECU_ADDRESS 0x0 /end MEASUREMENT
/begin CHARACTERISTIC VehicleModel.VehicelDynamicModel.Vehicle0.K "" VALUE 0x0 STANDARD_VALUE_R32 0.0 esdl_ident -3.4028234663852886E+38 3.4028234663852886E+38 /end CHARACTERISTIC
/begin MEASUREMENT VehicleModel.VehicelDynamicModel.Vehicle0.Hysteresis_Delta_RSP_instance.hysterese "" UBYTE esdl_ident 1 100.0 0 1 ECU_ADDRESS 0x0 BIT_MASK 0x1 /end MEASUREMENT
/begin MEASUREMENT VehicleModel.VehicelDynamicModel.Vehicle0.velocity_old "" FLOAT32_IEEE esdl_ident 1 100.0 -3.4028234663852886E+38 3.4028234663852886E+38 ECU_ADDRESS 0x0 /end MEASUREMENT
/begin MEASUREMENT VehicleModel.VehicelDynamicModel.Vehicle0.SlopeAcceleration "" FLOAT32_IEEE esdl_ident 1 100.0 -3.4028234663852886E+38 3.4028234663852886E+38 ECU_ADDRESS 0x0 /end MEASUREMENT
/begin MEASUREMENT VehicleModel.VehicelDynamicModel.Vehicle0.hold "" UBYTE esdl_ident 1 100.0 0 1 ECU_ADDRESS 0x0 BIT_MASK 0x1 /end MEASUREMENT
/begin MEASUREMENT VehicleModel.VehicelDynamicModel.Vehicle0.EdgeRising_instance.buffer "" UBYTE esdl_ident 1 100.0 0 1 ECU_ADDRESS 0x0 BIT_MASK 0x1 /end MEASUREMENT
/begin MEASUREMENT VehicleModel.VehicelDynamicModel.Vehicle0.EdgeRising_instance.oldSignal "" UBYTE esdl_ident 1 100.0 0 1 ECU_ADDRESS 0x0 BIT_MASK 0x1 /end MEASUREMENT
/begin CHARACTERISTIC VehicleModel.VehicelDynamicModel.Vehicle0.c_SlopePlus "" VALUE 0x0 STANDARD_VALUE_R32 0.0 esdl_ident -3.4028234663852886E+38 3.4028234663852886E+38 /end CHARACTERISTIC
/begin MEASUREMENT VehicleModel.VehicelDynamicModel.Vehicle0.VehicleDynamicModelClass_instance.SlopeAcceleration "" FLOAT32_IEEE esdl_ident 1 100.0 -3.4028234663852886E+38 3.4028234663852886E+38 ECU_ADDRESS 0x0 /end MEASUREMENT
/begin MEASUREMENT VehicleModel.VehicelDynamicModel.Vehicle0.VehicleDynamicModelClass_instance.hold "" UBYTE esdl_ident 1 100.0 0 1 ECU_ADDRESS 0x0 BIT_MASK 0x1 /end MEASUREMENT
/begin CHARACTERISTIC VehicleModel.VehicelDynamicModel.Vehicle0.VehicleDynamicModelClass_instance.c_SlopePlus "" VALUE 0x0 STANDARD_VALUE_R32 0.0 esdl_ident -3.4028234663852886E+38 3.4028234663852886E+38 /end CHARACTERISTIC
/begin MEASUREMENT VehicleModel.VehicelDynamicModel.Vehicle0.VehicleDynamicModelClass_instance.BrakeForce "" FLOAT32_IEEE esdl_ident 1 100.0 -3.4028234663852886E+38 3.4028234663852886E+38 ECU_ADDRESS 0x0 /end MEASUREMENT
/begin MEASUREMENT VehicleModel.VehicelDynamicModel.Vehicle0.VehicleDynamicModelClass_instance.velocity "" FLOAT32_IEEE esdl_ident 1 100.0 -3.4028234663852886E+38 3.4028234663852886E+38 ECU_ADDRESS 0x0 /end MEASUREMENT
/begin MEASUREMENT VehicleModel.VehicelDynamicModel.Vehicle0.VehicleDynamicModelClass_instance.velocity_old "" FLOAT32_IEEE esdl_ident 1 100.0 -3.4028234663852886E+38 3.4028234663852886E+38 ECU_ADDRESS 0x0 /end MEASUREMENT
/begin CHARACTERISTIC VehicleModel.VehicelDynamicModel.Vehicle0.VehicleDynamicModelClass_instance.BrakeForceCurve_instance "" CURVE 0x0 STANDARD_CURVE_R32R32 0.0 esdl_ident -3.4028234663852886E+38 3.4028234663852886E+38
 /begin AXIS_DESCR STD_AXIS NO_INPUT_QUANTITY esdl_ident 11 -3.4028234663852886E+38 3.4028234663852886E+38 /end AXIS_DESCR
/end CHARACTERISTIC
/begin MEASUREMENT VehicleModel.VehicelDynamicModel.Vehicle0.VehicleDynamicModelClass_instance.EdgeRising_instance.buffer "" UBYTE esdl_ident 1 100.0 0 1 ECU_ADDRESS 0x0 BIT_MASK 0x1 /end MEASUREMENT
/begin MEASUREMENT VehicleModel.VehicelDynamicModel.Vehicle0.VehicleDynamicModelClass_instance.EdgeRising_instance.oldSignal "" UBYTE esdl_ident 1 100.0 0 1 ECU_ADDRESS 0x0 BIT_MASK 0x1 /end MEASUREMENT
/begin MEASUREMENT VehicleModel.VehicelDynamicModel.Vehicle0.VehicleDynamicModelClass_instance.EngineForce "" FLOAT32_IEEE esdl_ident 1 100.0 -3.4028234663852886E+38 3.4028234663852886E+38 ECU_ADDRESS 0x0 /end MEASUREMENT
/begin CHARACTERISTIC VehicleModel.VehicelDynamicModel.Vehicle0.VehicleDynamicModelClass_instance.EngineForceCurve_instance "" CURVE 0x0 STANDARD_CURVE_R32R32 0.0 esdl_ident -3.4028234663852886E+38 3.4028234663852886E+38
 /begin AXIS_DESCR STD_AXIS NO_INPUT_QUANTITY esdl_ident 11 -3.4028234663852886E+38 3.4028234663852886E+38 /end AXIS_DESCR
/end CHARACTERISTIC
/begin CHARACTERISTIC VehicleModel.VehicelDynamicModel.Vehicle0.VehicleDynamicModelClass_instance.roh "" VALUE 0x0 STANDARD_VALUE_R32 0.0 esdl_ident -3.4028234663852886E+38 3.4028234663852886E+38 /end CHARACTERISTIC
/begin CHARACTERISTIC VehicleModel.VehicelDynamicModel.Vehicle0.VehicleDynamicModelClass_instance.cw "" VALUE 0x0 STANDARD_VALUE_R32 0.0 esdl_ident -3.4028234663852886E+38 3.4028234663852886E+38 /end CHARACTERISTIC
/begin CHARACTERISTIC VehicleModel.VehicelDynamicModel.Vehicle0.VehicleDynamicModelClass_instance.A "" VALUE 0x0 STANDARD_VALUE_R32 0.0 esdl_ident -3.4028234663852886E+38 3.4028234663852886E+38 /end CHARACTERISTIC
/begin MEASUREMENT VehicleModel.VehicelDynamicModel.Vehicle0.VehicleDynamicModelClass_instance.AirResistance "" FLOAT32_IEEE esdl_ident 1 100.0 -3.4028234663852886E+38 3.4028234663852886E+38 ECU_ADDRESS 0x0 /end MEASUREMENT
/begin CHARACTERISTIC VehicleModel.VehicelDynamicModel.Vehicle0.VehicleDynamicModelClass_instance.vehicle_mass "" VALUE 0x0 STANDARD_VALUE_R32 0.0 esdl_ident -3.4028234663852886E+38 3.4028234663852886E+38 /end CHARACTERISTIC
/begin MEASUREMENT VehicleModel.VehicelDynamicModel.Vehicle0.VehicleDynamicModelClass_instance.IntegratorK_instance.memory "" FLOAT32_IEEE esdl_ident 1 100.0 -3.4028234663852886E+38 3.4028234663852886E+38 ECU_ADDRESS 0x0 /end MEASUREMENT
/begin CHARACTERISTIC VehicleModel.VehicelDynamicModel.Vehicle0.VehicleDynamicModelClass_instance.K "" VALUE 0x0 STANDARD_VALUE_R32 0.0 esdl_ident -3.4028234663852886E+38 3.4028234663852886E+38 /end CHARACTERISTIC
/begin MEASUREMENT VehicleModel.VehicelDynamicModel.Vehicle0.VehicleDynamicModelClass_instance_2.SlopeAcceleration "" FLOAT32_IEEE esdl_ident 1 100.0 -3.4028234663852886E+38 3.4028234663852886E+38 ECU_ADDRESS 0x0 /end MEASUREMENT
/begin MEASUREMENT VehicleModel.VehicelDynamicModel.Vehicle0.VehicleDynamicModelClass_instance_2.hold "" UBYTE esdl_ident 1 100.0 0 1 ECU_ADDRESS 0x0 BIT_MASK 0x1 /end MEASUREMENT
/begin CHARACTERISTIC VehicleModel.VehicelDynamicModel.Vehicle0.VehicleDynamicModelClass_instance_2.c_SlopePlus "" VALUE 0x0 STANDARD_VALUE_R32 0.0 esdl_ident -3.4028234663852886E+38 3.4028234663852886E+38 /end CHARACTERISTIC
/begin MEASUREMENT VehicleModel.VehicelDynamicModel.Vehicle0.VehicleDynamicModelClass_instance_2.BrakeForce "" FLOAT32_IEEE esdl_ident 1 100.0 -3.4028234663852886E+38 3.4028234663852886E+38 ECU_ADDRESS 0x0 /end MEASUREMENT
/begin MEASUREMENT VehicleModel.VehicelDynamicModel.Vehicle0.VehicleDynamicModelClass_instance_2.velocity "" FLOAT32_IEEE esdl_ident 1 100.0 -3.4028234663852886E+38 3.4028234663852886E+38 ECU_ADDRESS 0x0 /end MEASUREMENT
/begin MEASUREMENT VehicleModel.VehicelDynamicModel.Vehicle0.VehicleDynamicModelClass_instance_2.velocity_old "" FLOAT32_IEEE esdl_ident 1 100.0 -3.4028234663852886E+38 3.4028234663852886E+38 ECU_ADDRESS 0x0 /end MEASUREMENT
/begin CHARACTERISTIC VehicleModel.VehicelDynamicModel.Vehicle0.VehicleDynamicModelClass_instance_2.BrakeForceCurve_instance "" CURVE 0x0 STANDARD_CURVE_R32R32 0.0 esdl_ident -3.4028234663852886E+38 3.4028234663852886E+38
 /begin AXIS_DESCR STD_AXIS NO_INPUT_QUANTITY esdl_ident 11 -3.4028234663852886E+38 3.4028234663852886E+38 /end AXIS_DESCR
/end CHARACTERISTIC
/begin MEASUREMENT VehicleModel.VehicelDynamicModel.Vehicle0.VehicleDynamicModelClass_instance_2.EdgeRising_instance.buffer "" UBYTE esdl_ident 1 100.0 0 1 ECU_ADDRESS 0x0 BIT_MASK 0x1 /end MEASUREMENT
/begin MEASUREMENT VehicleModel.VehicelDynamicModel.Vehicle0.VehicleDynamicModelClass_instance_2.EdgeRising_instance.oldSignal "" UBYTE esdl_ident 1 100.0 0 1 ECU_ADDRESS 0x0 BIT_MASK 0x1 /end MEASUREMENT
/begin MEASUREMENT VehicleModel.VehicelDynamicModel.Vehicle0.VehicleDynamicModelClass_instance_2.EngineForce "" FLOAT32_IEEE esdl_ident 1 100.0 -3.4028234663852886E+38 3.4028234663852886E+38 ECU_ADDRESS 0x0 /end MEASUREMENT
/begin CHARACTERISTIC VehicleModel.VehicelDynamicModel.Vehicle0.VehicleDynamicModelClass_instance_2.EngineForceCurve_instance "" CURVE 0x0 STANDARD_CURVE_R32R32 0.0 esdl_ident -3.4028234663852886E+38 3.4028234663852886E+38
 /begin AXIS_DESCR STD_AXIS NO_INPUT_QUANTITY esdl_ident 11 -3.4028234663852886E+38 3.4028234663852886E+38 /end AXIS_DESCR
/end CHARACTERISTIC
/begin CHARACTERISTIC VehicleModel.VehicelDynamicModel.Vehicle0.VehicleDynamicModelClass_instance_2.roh "" VALUE 0x0 STANDARD_VALUE_R32 0.0 esdl_ident -3.4028234663852886E+38 3.4028234663852886E+38 /end CHARACTERISTIC
/begin CHARACTERISTIC VehicleModel.VehicelDynamicModel.Vehicle0.VehicleDynamicModelClass_instance_2.cw "" VALUE 0x0 STANDARD_VALUE_R32 0.0 esdl_ident -3.4028234663852886E+38 3.4028234663852886E+38 /end CHARACTERISTIC
/begin CHARACTERISTIC VehicleModel.VehicelDynamicModel.Vehicle0.VehicleDynamicModelClass_instance_2.A "" VALUE 0x0 STANDARD_VALUE_R32 0.0 esdl_ident -3.4028234663852886E+38 3.4028234663852886E+38 /end CHARACTERISTIC
/begin MEASUREMENT VehicleModel.VehicelDynamicModel.Vehicle0.VehicleDynamicModelClass_instance_2.AirResistance "" FLOAT32_IEEE esdl_ident 1 100.0 -3.4028234663852886E+38 3.4028234663852886E+38 ECU_ADDRESS 0x0 /end MEASUREMENT
/begin CHARACTERISTIC VehicleModel.VehicelDynamicModel.Vehicle0.VehicleDynamicModelClass_instance_2.vehicle_mass "" VALUE 0x0 STANDARD_VALUE_R32 0.0 esdl_ident -3.4028234663852886E+38 3.4028234663852886E+38 /end CHARACTERISTIC
/begin MEASUREMENT VehicleModel.VehicelDynamicModel.Vehicle0.VehicleDynamicModelClass_instance_2.IntegratorK_instance.memory "" FLOAT32_IEEE esdl_ident 1 100.0 -3.4028234663852886E+38 3.4028234663852886E+38 ECU_ADDRESS 0x0 /end MEASUREMENT
/begin CHARACTERISTIC VehicleModel.VehicelDynamicModel.Vehicle0.VehicleDynamicModelClass_instance_2.K "" VALUE 0x0 STANDARD_VALUE_R32 0.0 esdl_ident -3.4028234663852886E+38 3.4028234663852886E+38 /end CHARACTERISTIC
/begin CHARACTERISTIC ACC.ACC_SWC.Time_Gap "" VALUE 0x0 STANDARD_VALUE_R32 0.0 esdl_ident -3.4028234663852886E+38 3.4028234663852886E+38 /end CHARACTERISTIC
/begin CHARACTERISTIC ACC.ACC_SWC.Velocity_Error_Gain "" VALUE 0x0 STANDARD_VALUE_R32 0.0 esdl_ident -3.4028234663852886E+38 3.4028234663852886E+38 /end CHARACTERISTIC
/begin CHARACTERISTIC ACC.ACC_SWC.Spacing_Error_Gain "" VALUE 0x0 STANDARD_VALUE_R32 0.0 esdl_ident -3.4028234663852886E+38 3.4028234663852886E+38 /end CHARACTERISTIC
/begin CHARACTERISTIC ACC.ACC_SWC.Relative_Velocity_Gain "" VALUE 0x0 STANDARD_VALUE_R32 0.0 esdl_ident -3.4028234663852886E+38 3.4028234663852886E+38 /end CHARACTERISTIC
/begin CHARACTERISTIC ACC.ACC_SWC.Default_Distance "" VALUE 0x0 STANDARD_VALUE_R32 0.0 esdl_ident -3.4028234663852886E+38 3.4028234663852886E+38 /end CHARACTERISTIC
/begin CHARACTERISTIC VehicleModel.CalibrationMapping.CalibrationInterfaceModel.c_CC_ControlValue_acc "" VALUE 0x0 STANDARD_VALUE_R32 0.0 esdl_ident -3.4028234663852886E+38 3.4028234663852886E+38 /end CHARACTERISTIC
/begin CHARACTERISTIC VehicleModel.CalibrationMapping.CalibrationInterfaceModel.c_CC_ControlValue_brake "" VALUE 0x0 STANDARD_VALUE_R32 0.0 esdl_ident -3.4028234663852886E+38 3.4028234663852886E+38 /end CHARACTERISTIC
/begin CHARACTERISTIC VehicleModel.CalibrationMapping.CalibrationInterfaceModel.c_RoadSlopeSet "" VALUE 0x0 STANDARD_VALUE_R32 0.0 esdl_ident -3.4028234663852886E+38 3.4028234663852886E+38 /end CHARACTERISTIC
/begin CHARACTERISTIC VehicleModel.CalibrationMapping.CalibrationInterfaceModel.c_WindSpeed "" VALUE 0x0 STANDARD_VALUE_R32 0.0 esdl_ident -3.4028234663852886E+38 3.4028234663852886E+38 /end CHARACTERISTIC
/begin CHARACTERISTIC VehicleModel.CalibrationMapping.CalibrationInterfaceModel.Set_ACC_Velocity "" VALUE 0x0 STANDARD_VALUE_R32 0.0 esdl_ident -3.4028234663852886E+38 3.4028234663852886E+38 /end CHARACTERISTIC
/begin CHARACTERISTIC VehicleModel.CalibrationMapping.CalibrationInterfaceModel.Set_Velocity_LC "" VALUE 0x0 STANDARD_VALUE_R32 0.0 esdl_ident -3.4028234663852886E+38 3.4028234663852886E+38 /end CHARACTERISTIC
/begin MEASUREMENT VehicleModel.RelativeData.RelativeData.Position_EC.memory "" FLOAT32_IEEE esdl_ident 1 100.0 -3.4028234663852886E+38 3.4028234663852886E+38 ECU_ADDRESS 0x0 /end MEASUREMENT
/begin MEASUREMENT VehicleModel.RelativeData.RelativeData.Position_LC.memory "" FLOAT32_IEEE esdl_ident 1 100.0 -3.4028234663852886E+38 3.4028234663852886E+38 ECU_ADDRESS 0x0 /end MEASUREMENT
/begin MEASUREMENT VehicleModel.RelativeData.RelativeData.v "" FLOAT32_IEEE esdl_ident 1 100.0 -3.4028234663852886E+38 3.4028234663852886E+38 ECU_ADDRESS 0x0 /end MEASUREMENT
/begin MEASUREMENT VehicleModel.DataDefinitionFiles.CruiseControlInterface.CC_SetPlus "" UBYTE esdl_ident 1 100.0 0 1 ECU_ADDRESS 0x0 BIT_MASK 0x1 /end MEASUREMENT
/begin MEASUREMENT VehicleModel.DataDefinitionFiles.CruiseControlInterface.CC_SetMinus "" UBYTE esdl_ident 1 100.0 0 1 ECU_ADDRESS 0x0 BIT_MASK 0x1 /end MEASUREMENT
/begin MEASUREMENT VehicleModel.DataDefinitionFiles.CruiseControlInterface.CC_Resume "" UBYTE esdl_ident 1 100.0 0 1 ECU_ADDRESS 0x0 BIT_MASK 0x1 /end MEASUREMENT
/begin MEASUREMENT VehicleModel.DataDefinitionFiles.CruiseControlInterface.CC_Cancel "" UBYTE esdl_ident 1 100.0 0 1 ECU_ADDRESS 0x0 BIT_MASK 0x1 /end MEASUREMENT
/begin MEASUREMENT VehicleModel.DataDefinitionFiles.CruiseControlInterface.Accelerator_pedal "" FLOAT32_IEEE esdl_ident 1 100.0 -3.4028234663852886E+38 3.4028234663852886E+38 ECU_ADDRESS 0x0 /end MEASUREMENT
/begin MEASUREMENT VehicleModel.DataDefinitionFiles.CruiseControlInterface.Brake_pedal "" FLOAT32_IEEE esdl_ident 1 100.0 -3.4028234663852886E+38 3.4028234663852886E+38 ECU_ADDRESS 0x0 /end MEASUREMENT
/begin MEASUREMENT VehicleModel.DataDefinitionFiles.CruiseControlInterface.CurrentSpeed "" FLOAT32_IEEE esdl_ident 1 100.0 -3.4028234663852886E+38 3.4028234663852886E+38 ECU_ADDRESS 0x0 /end MEASUREMENT
/begin MEASUREMENT VehicleModel.DataDefinitionFiles.CruiseControlInterface.CC_ControlValue_acc "" FLOAT32_IEEE esdl_ident 1 100.0 -3.4028234663852886E+38 3.4028234663852886E+38 ECU_ADDRESS 0x0 /end MEASUREMENT
/begin MEASUREMENT VehicleModel.DataDefinitionFiles.CruiseControlInterface.CC_ControlValue_brake "" FLOAT32_IEEE esdl_ident 1 100.0 -3.4028234663852886E+38 3.4028234663852886E+38 ECU_ADDRESS 0x0 /end MEASUREMENT
/begin MEASUREMENT VehicleModel.DataDefinitionFiles.CruiseControlInterface.RoadSlopeSet "" FLOAT32_IEEE esdl_ident 1 100.0 -3.4028234663852886E+38 3.4028234663852886E+38 ECU_ADDRESS 0x0 /end MEASUREMENT
/begin MEASUREMENT VehicleModel.DataDefinitionFiles.CruiseControlInterface.WindSpeed "" FLOAT32_IEEE esdl_ident 1 100.0 -3.4028234663852886E+38 3.4028234663852886E+38 ECU_ADDRESS 0x0 /end MEASUREMENT
/begin MEASUREMENT VehicleModel.DataDefinitionFiles.CruiseControlInterface.MainSwitch "" UBYTE esdl_VehicleModel_DataDefinitionFiles_CruiseControlMainStates 1 100.0 0 3 ECU_ADDRESS 0x0 /end MEASUREMENT
/begin MEASUREMENT interfaces.messages.Actual_Velocity_LC "" FLOAT32_IEEE esdl_ident 1 100.0 -3.4028234663852886E+38 3.4028234663852886E+38 ECU_ADDRESS 0x0 /end MEASUREMENT
/begin MEASUREMENT interfaces.messages.Actual_Velocity_EC "" FLOAT32_IEEE esdl_ident 1 100.0 -3.4028234663852886E+38 3.4028234663852886E+38 ECU_ADDRESS 0x0 /end MEASUREMENT
/begin MEASUREMENT interfaces.messages.Actual_Position_LC "" FLOAT32_IEEE esdl_ident 1 100.0 -3.4028234663852886E+38 3.4028234663852886E+38 ECU_ADDRESS 0x0 /end MEASUREMENT
/begin MEASUREMENT interfaces.messages.Actual_Position_EC "" FLOAT32_IEEE esdl_ident 1 100.0 -3.4028234663852886E+38 3.4028234663852886E+38 ECU_ADDRESS 0x0 /end MEASUREMENT
/begin MEASUREMENT interfaces.messages.Relative_Distance "" FLOAT32_IEEE esdl_ident 1 100.0 -3.4028234663852886E+38 3.4028234663852886E+38 ECU_ADDRESS 0x0 /end MEASUREMENT
/begin MEASUREMENT interfaces.messages.Relative_Velocity "" FLOAT32_IEEE esdl_ident 1 100.0 -3.4028234663852886E+38 3.4028234663852886E+38 ECU_ADDRESS 0x0 /end MEASUREMENT
/begin MEASUREMENT interfaces.messages.Set_Velocity "" FLOAT32_IEEE esdl_ident 1 100.0 -3.4028234663852886E+38 3.4028234663852886E+38 ECU_ADDRESS 0x0 /end MEASUREMENT
/begin MEASUREMENT interfaces.messages.Acceleration_EC "" FLOAT32_IEEE esdl_ident 1 100.0 -3.4028234663852886E+38 3.4028234663852886E+38 ECU_ADDRESS 0x0 /end MEASUREMENT
/begin MEASUREMENT interfaces.messages.Safe_Distance "" FLOAT32_IEEE esdl_ident 1 100.0 -3.4028234663852886E+38 3.4028234663852886E+38 ECU_ADDRESS 0x0 /end MEASUREMENT
/begin COMPU_METHOD esdl_VehicleModel_DataDefinitionFiles_CruiseControlMainStates "" TAB_VERB /* format */ "%12.4" /* unit */ "" /* compu_tab_ref */ COMPU_TAB_REF esdl_VehicleModel_DataDefinitionFiles_CruiseControlMainStates_vtab /end COMPU_METHOD
/begin COMPU_VTAB esdl_VehicleModel_DataDefinitionFiles_CruiseControlMainStates_vtab "" TAB_VERB /* number value pairs */ 4 0 "Error" 1 "Off" 2 "SpeedControl" 3 "SpeedLimit" /* default value */ DEFAULT_VALUE "Error" /end COMPU_VTAB
/begin COMPU_METHOD esdl_ident "" RAT_FUNC /* format */ "%12.4" /* unit */ "" /* coeffs */ COEFFS 0 1 0 0 0 1 /end COMPU_METHOD
/begin FUNCTION VehicleModel.VehicelDynamicModel.Vehicle0 ""
 /begin DEF_CHARACTERISTIC VehicleModel.VehicelDynamicModel.Vehicle0.A VehicleModel.VehicelDynamicModel.Vehicle0.cw VehicleModel.VehicelDynamicModel.Vehicle0.vehicle_mass VehicleModel.VehicelDynamicModel.Vehicle0.roh VehicleModel.VehicelDynamicModel.Vehicle0.EngineForceCurve_instance VehicleModel.VehicelDynamicModel.Vehicle0.BrakeForceCurve_instance VehicleModel.VehicelDynamicModel.Vehicle0.K VehicleModel.VehicelDynamicModel.Vehicle0.c_SlopePlus /end DEF_CHARACTERISTIC
 /begin IN_MEASUREMENT VehicleModel.DataDefinitionFiles.CruiseControlInterface.CC_ControlValue_brake VehicleModel.DataDefinitionFiles.CruiseControlInterface.RoadSlopeSet VehicleModel.DataDefinitionFiles.CruiseControlInterface.WindSpeed interfaces.messages.Acceleration_EC /end IN_MEASUREMENT
 /begin OUT_MEASUREMENT interfaces.messages.Actual_Velocity_EC interfaces.messages.Relative_Velocity /end OUT_MEASUREMENT
 /begin LOC_MEASUREMENT VehicleModel.VehicelDynamicModel.Vehicle0.AirResistance VehicleModel.VehicelDynamicModel.Vehicle0.BrakeForce VehicleModel.VehicelDynamicModel.Vehicle0.EngineForce VehicleModel.VehicelDynamicModel.Vehicle0.SlopeAcceleration VehicleModel.VehicelDynamicModel.Vehicle0.hold VehicleModel.VehicelDynamicModel.Vehicle0.velocity VehicleModel.VehicelDynamicModel.Vehicle0.velocity_old /end LOC_MEASUREMENT
 /begin SUB_FUNCTION VehicleModel.VehicelDynamicModel.Vehicle0.IntegratorK_instance VehicleModel.VehicelDynamicModel.Vehicle0.Hysteresis_Delta_RSP_instance VehicleModel.VehicelDynamicModel.Vehicle0.EdgeRising_instance VehicleModel.VehicelDynamicModel.Vehicle0.VehicleDynamicModelClass_instance VehicleModel.VehicelDynamicModel.Vehicle0.VehicleDynamicModelClass_instance_2 /end SUB_FUNCTION
/end FUNCTION
/begin FUNCTION VehicleModel.VehicelDynamicModel.Vehicle0.IntegratorK_instance "IntegratorK is a time discrete integrator with gain constant K."
 /begin LOC_MEASUREMENT VehicleModel.VehicelDynamicModel.Vehicle0.IntegratorK_instance.memory /end LOC_MEASUREMENT
/end FUNCTION
/begin FUNCTION VehicleModel.VehicelDynamicModel.Vehicle0.Hysteresis_Delta_RSP_instance "Hysteresis-Delta-RSP is a hysteresis with a right switching point and a delta offset"
 /begin LOC_MEASUREMENT VehicleModel.VehicelDynamicModel.Vehicle0.Hysteresis_Delta_RSP_instance.hysterese /end LOC_MEASUREMENT
/end FUNCTION
/begin FUNCTION VehicleModel.VehicelDynamicModel.Vehicle0.EdgeRising_instance "EdgeRising detects a rising edge of the logical input signal."
 /begin LOC_MEASUREMENT VehicleModel.VehicelDynamicModel.Vehicle0.EdgeRising_instance.buffer VehicleModel.VehicelDynamicModel.Vehicle0.EdgeRising_instance.oldSignal /end LOC_MEASUREMENT
/end FUNCTION
/begin FUNCTION VehicleModel.VehicelDynamicModel.Vehicle0.VehicleDynamicModelClass_instance ""
 /begin DEF_CHARACTERISTIC VehicleModel.VehicelDynamicModel.Vehicle0.VehicleDynamicModelClass_instance.c_SlopePlus VehicleModel.VehicelDynamicModel.Vehicle0.VehicleDynamicModelClass_instance.BrakeForceCurve_instance VehicleModel.VehicelDynamicModel.Vehicle0.VehicleDynamicModelClass_instance.EngineForceCurve_instance VehicleModel.VehicelDynamicModel.Vehicle0.VehicleDynamicModelClass_instance.roh VehicleModel.VehicelDynamicModel.Vehicle0.VehicleDynamicModelClass_instance.cw VehicleModel.VehicelDynamicModel.Vehicle0.VehicleDynamicModelClass_instance.A VehicleModel.VehicelDynamicModel.Vehicle0.VehicleDynamicModelClass_instance.vehicle_mass VehicleModel.VehicelDynamicModel.Vehicle0.VehicleDynamicModelClass_instance.K /end DEF_CHARACTERISTIC
 /begin LOC_MEASUREMENT VehicleModel.VehicelDynamicModel.Vehicle0.VehicleDynamicModelClass_instance.AirResistance VehicleModel.VehicelDynamicModel.Vehicle0.VehicleDynamicModelClass_instance.BrakeForce VehicleModel.VehicelDynamicModel.Vehicle0.VehicleDynamicModelClass_instance.EngineForce VehicleModel.VehicelDynamicModel.Vehicle0.VehicleDynamicModelClass_instance.SlopeAcceleration VehicleModel.VehicelDynamicModel.Vehicle0.VehicleDynamicModelClass_instance.hold VehicleModel.VehicelDynamicModel.Vehicle0.VehicleDynamicModelClass_instance.velocity VehicleModel.VehicelDynamicModel.Vehicle0.VehicleDynamicModelClass_instance.velocity_old /end LOC_MEASUREMENT
 /begin SUB_FUNCTION VehicleModel.VehicelDynamicModel.Vehicle0.VehicleDynamicModelClass_instance.EdgeRising_instance VehicleModel.VehicelDynamicModel.Vehicle0.VehicleDynamicModelClass_instance.IntegratorK_instance /end SUB_FUNCTION
/end FUNCTION
/begin FUNCTION VehicleModel.VehicelDynamicModel.Vehicle0.VehicleDynamicModelClass_instance.EdgeRising_instance "EdgeRising detects a rising edge of the logical input signal."
 /begin LOC_MEASUREMENT VehicleModel.VehicelDynamicModel.Vehicle0.VehicleDynamicModelClass_instance.EdgeRising_instance.buffer VehicleModel.VehicelDynamicModel.Vehicle0.VehicleDynamicModelClass_instance.EdgeRising_instance.oldSignal /end LOC_MEASUREMENT
/end FUNCTION
/begin FUNCTION VehicleModel.VehicelDynamicModel.Vehicle0.VehicleDynamicModelClass_instance.IntegratorK_instance "IntegratorK is a time discrete integrator with gain constant K."
 /begin LOC_MEASUREMENT VehicleModel.VehicelDynamicModel.Vehicle0.VehicleDynamicModelClass_instance.IntegratorK_instance.memory /end LOC_MEASUREMENT
/end FUNCTION
/begin FUNCTION VehicleModel.VehicelDynamicModel.Vehicle0.VehicleDynamicModelClass_instance_2 ""
 /begin DEF_CHARACTERISTIC VehicleModel.VehicelDynamicModel.Vehicle0.VehicleDynamicModelClass_instance_2.c_SlopePlus VehicleModel.VehicelDynamicModel.Vehicle0.VehicleDynamicModelClass_instance_2.BrakeForceCurve_instance VehicleModel.VehicelDynamicModel.Vehicle0.VehicleDynamicModelClass_instance_2.EngineForceCurve_instance VehicleModel.VehicelDynamicModel.Vehicle0.VehicleDynamicModelClass_instance_2.roh VehicleModel.VehicelDynamicModel.Vehicle0.VehicleDynamicModelClass_instance_2.cw VehicleModel.VehicelDynamicModel.Vehicle0.VehicleDynamicModelClass_instance_2.A VehicleModel.VehicelDynamicModel.Vehicle0.VehicleDynamicModelClass_instance_2.vehicle_mass VehicleModel.VehicelDynamicModel.Vehicle0.VehicleDynamicModelClass_instance_2.K /end DEF_CHARACTERISTIC
 /begin LOC_MEASUREMENT VehicleModel.VehicelDynamicModel.Vehicle0.VehicleDynamicModelClass_instance_2.AirResistance VehicleModel.VehicelDynamicModel.Vehicle0.VehicleDynamicModelClass_instance_2.BrakeForce VehicleModel.VehicelDynamicModel.Vehicle0.VehicleDynamicModelClass_instance_2.EngineForce VehicleModel.VehicelDynamicModel.Vehicle0.VehicleDynamicModelClass_instance_2.SlopeAcceleration VehicleModel.VehicelDynamicModel.Vehicle0.VehicleDynamicModelClass_instance_2.hold VehicleModel.VehicelDynamicModel.Vehicle0.VehicleDynamicModelClass_instance_2.velocity VehicleModel.VehicelDynamicModel.Vehicle0.VehicleDynamicModelClass_instance_2.velocity_old /end LOC_MEASUREMENT
 /begin SUB_FUNCTION VehicleModel.VehicelDynamicModel.Vehicle0.VehicleDynamicModelClass_instance_2.EdgeRising_instance VehicleModel.VehicelDynamicModel.Vehicle0.VehicleDynamicModelClass_instance_2.IntegratorK_instance /end SUB_FUNCTION
/end FUNCTION
/begin FUNCTION VehicleModel.VehicelDynamicModel.Vehicle0.VehicleDynamicModelClass_instance_2.EdgeRising_instance "EdgeRising detects a rising edge of the logical input signal."
 /begin LOC_MEASUREMENT VehicleModel.VehicelDynamicModel.Vehicle0.VehicleDynamicModelClass_instance_2.EdgeRising_instance.buffer VehicleModel.VehicelDynamicModel.Vehicle0.VehicleDynamicModelClass_instance_2.EdgeRising_instance.oldSignal /end LOC_MEASUREMENT
/end FUNCTION
/begin FUNCTION VehicleModel.VehicelDynamicModel.Vehicle0.VehicleDynamicModelClass_instance_2.IntegratorK_instance "IntegratorK is a time discrete integrator with gain constant K."
 /begin LOC_MEASUREMENT VehicleModel.VehicelDynamicModel.Vehicle0.VehicleDynamicModelClass_instance_2.IntegratorK_instance.memory /end LOC_MEASUREMENT
/end FUNCTION
/begin FUNCTION ACC.ACC_SWC ""
 /begin DEF_CHARACTERISTIC ACC.ACC_SWC.Time_Gap ACC.ACC_SWC.Velocity_Error_Gain ACC.ACC_SWC.Spacing_Error_Gain ACC.ACC_SWC.Relative_Velocity_Gain ACC.ACC_SWC.Default_Distance /end DEF_CHARACTERISTIC
 /begin IN_MEASUREMENT interfaces.messages.Actual_Velocity_EC interfaces.messages.Relative_Distance interfaces.messages.Relative_Velocity interfaces.messages.Set_Velocity /end IN_MEASUREMENT
 /begin OUT_MEASUREMENT interfaces.messages.Acceleration_EC interfaces.messages.Safe_Distance /end OUT_MEASUREMENT
/end FUNCTION
/begin FUNCTION VehicleModel.CalibrationMapping.CalibrationInterfaceModel ""
 /begin DEF_CHARACTERISTIC VehicleModel.CalibrationMapping.CalibrationInterfaceModel.c_CC_ControlValue_acc VehicleModel.CalibrationMapping.CalibrationInterfaceModel.c_CC_ControlValue_brake VehicleModel.CalibrationMapping.CalibrationInterfaceModel.c_RoadSlopeSet VehicleModel.CalibrationMapping.CalibrationInterfaceModel.c_WindSpeed VehicleModel.CalibrationMapping.CalibrationInterfaceModel.Set_ACC_Velocity VehicleModel.CalibrationMapping.CalibrationInterfaceModel.Set_Velocity_LC /end DEF_CHARACTERISTIC
 /begin OUT_MEASUREMENT VehicleModel.DataDefinitionFiles.CruiseControlInterface.Accelerator_pedal VehicleModel.DataDefinitionFiles.CruiseControlInterface.Brake_pedal VehicleModel.DataDefinitionFiles.CruiseControlInterface.CC_ControlValue_acc VehicleModel.DataDefinitionFiles.CruiseControlInterface.CC_ControlValue_brake VehicleModel.DataDefinitionFiles.CruiseControlInterface.RoadSlopeSet VehicleModel.DataDefinitionFiles.CruiseControlInterface.WindSpeed interfaces.messages.Actual_Velocity_LC interfaces.messages.Set_Velocity /end OUT_MEASUREMENT
/end FUNCTION
/begin FUNCTION VehicleModel.RelativeData.RelativeData ""
 /begin IN_MEASUREMENT interfaces.messages.Actual_Velocity_EC interfaces.messages.Actual_Velocity_LC /end IN_MEASUREMENT
 /begin OUT_MEASUREMENT interfaces.messages.Actual_Position_EC interfaces.messages.Actual_Position_LC interfaces.messages.Relative_Distance interfaces.messages.Relative_Velocity /end OUT_MEASUREMENT
 /begin LOC_MEASUREMENT VehicleModel.RelativeData.RelativeData.v /end LOC_MEASUREMENT
 /begin SUB_FUNCTION VehicleModel.RelativeData.RelativeData.Position_EC VehicleModel.RelativeData.RelativeData.Position_LC /end SUB_FUNCTION
/end FUNCTION
/begin FUNCTION VehicleModel.RelativeData.RelativeData.Position_EC "IntegratorK is a time discrete integrator with gain constant K." /begin LOC_MEASUREMENT VehicleModel.RelativeData.RelativeData.Position_EC.memory /end LOC_MEASUREMENT /end FUNCTION
/begin FUNCTION VehicleModel.RelativeData.RelativeData.Position_LC "IntegratorK is a time discrete integrator with gain constant K." /begin LOC_MEASUREMENT VehicleModel.RelativeData.RelativeData.Position_LC.memory /end LOC_MEASUREMENT /end FUNCTION
/begin RECORD_LAYOUT STANDARD_CURVE_R32R32 /* axis size */ NO_AXIS_PTS_X 1 UWORD /* axis */ AXIS_PTS_X 2 FLOAT32_IEEE INDEX_INCR DIRECT /* value */ FNC_VALUES 3 FLOAT32_IEEE COLUMN_DIR DIRECT /end RECORD_LAYOUT
/begin RECORD_LAYOUT STANDARD_VALUE_R32 /* value */ FNC_VALUES 1 FLOAT32_IEEE COLUMN_DIR DIRECT /end RECORD_LAYOUT
/begin GROUP ACC.ACC_SWC "" ROOT
 /begin REF_CHARACTERISTIC ACC.ACC_SWC.Time_Gap ACC.ACC_SWC.Velocity_Error_Gain ACC.ACC_SWC.Spacing_Error_Gain ACC.ACC_SWC.Relative_Velocity_Gain ACC.ACC_SWC.Default_Distance /end REF_CHARACTERISTIC
/end GROUP
/begin GROUP VehicleModel.CalibrationMapping.CalibrationInterfaceModel "" ROOT
 /begin REF_CHARACTERISTIC VehicleModel.CalibrationMapping.CalibrationInterfaceModel.c_CC_ControlValue_acc VehicleModel.CalibrationMapping.CalibrationInterfaceModel.c_CC_ControlValue_brake VehicleModel.CalibrationMapping.CalibrationInterfaceModel.c_RoadSlopeSet VehicleModel.CalibrationMapping.CalibrationInterfaceModel.c_WindSpeed VehicleModel.CalibrationMapping.CalibrationInterfaceModel.Set_ACC_Velocity VehicleModel.CalibrationMapping.CalibrationInterfaceModel.Set_Velocity_LC /end REF_CHARACTERISTIC
/end GROUP
/begin GROUP VehicleModel.DataDefinitionFiles.CruiseControlInterface "" ROOT
 /begin REF_MEASUREMENT VehicleModel.DataDefinitionFiles.CruiseControlInterface.Accelerator_pedal VehicleModel.DataDefinitionFiles.CruiseControlInterface.Brake_pedal VehicleModel.DataDefinitionFiles.CruiseControlInterface.CC_Cancel VehicleModel.DataDefinitionFiles.CruiseControlInterface.CC_ControlValue_acc VehicleModel.DataDefinitionFiles.CruiseControlInterface.CC_ControlValue_brake VehicleModel.DataDefinitionFiles.CruiseControlInterface.CC_Resume VehicleModel.DataDefinitionFiles.CruiseControlInterface.CC_SetMinus VehicleModel.DataDefinitionFiles.CruiseControlInterface.CC_SetPlus VehicleModel.DataDefinitionFiles.CruiseControlInterface.CurrentSpeed VehicleModel.DataDefinitionFiles.CruiseControlInterface.MainSwitch VehicleModel.DataDefinitionFiles.CruiseControlInterface.RoadSlopeSet VehicleModel.DataDefinitionFiles.CruiseControlInterface.WindSpeed /end REF_MEASUREMENT
/end GROUP
/begin GROUP VehicleModel.RelativeData.RelativeData "" ROOT /begin REF_MEASUREMENT VehicleModel.RelativeData.RelativeData.v /end REF_MEASUREMENT
 /begin SUB_GROUP VehicleModel.RelativeData.RelativeData.Position_EC VehicleModel.RelativeData.RelativeData.Position_LC /end SUB_GROUP
/end GROUP
/begin GROUP VehicleModel.RelativeData.RelativeData.Position_EC "IntegratorK is a time discrete integrator with gain constant K." /begin REF_MEASUREMENT VehicleModel.RelativeData.RelativeData.Position_EC.memory /end REF_MEASUREMENT /end GROUP
/begin GROUP VehicleModel.RelativeData.RelativeData.Position_LC "IntegratorK is a time discrete integrator with gain constant K." /begin REF_MEASUREMENT VehicleModel.RelativeData.RelativeData.Position_LC.memory /end REF_MEASUREMENT /end GROUP
/begin GROUP VehicleModel.VehicelDynamicModel.Vehicle0 "" ROOT
 /begin REF_CHARACTERISTIC VehicleModel.VehicelDynamicModel.Vehicle0.A VehicleModel.VehicelDynamicModel.Vehicle0.cw VehicleModel.VehicelDynamicModel.Vehicle0.vehicle_mass VehicleModel.VehicelDynamicModel.Vehicle0.roh VehicleModel.VehicelDynamicModel.Vehicle0.EngineForceCurve_instance VehicleModel.VehicelDynamicModel.Vehicle0.BrakeForceCurve_instance VehicleModel.VehicelDynamicModel.Vehicle0.K VehicleModel.VehicelDynamicModel.Vehicle0.c_SlopePlus /end REF_CHARACTERISTIC
 /begin REF_MEASUREMENT VehicleModel.VehicelDynamicModel.Vehicle0.AirResistance VehicleModel.VehicelDynamicModel.Vehicle0.BrakeForce VehicleModel.VehicelDynamicModel.Vehicle0.EngineForce VehicleModel.VehicelDynamicModel.Vehicle0.SlopeAcceleration VehicleModel.VehicelDynamicModel.Vehicle0.hold VehicleModel.VehicelDynamicModel.Vehicle0.velocity VehicleModel.VehicelDynamicModel.Vehicle0.velocity_old /end REF_MEASUREMENT
 /begin SUB_GROUP VehicleModel.VehicelDynamicModel.Vehicle0.IntegratorK_instance VehicleModel.VehicelDynamicModel.Vehicle0.Hysteresis_Delta_RSP_instance VehicleModel.VehicelDynamicModel.Vehicle0.EdgeRising_instance VehicleModel.VehicelDynamicModel.Vehicle0.VehicleDynamicModelClass_instance VehicleModel.VehicelDynamicModel.Vehicle0.VehicleDynamicModelClass_instance_2 /end SUB_GROUP
/end GROUP
/begin GROUP VehicleModel.VehicelDynamicModel.Vehicle0.EdgeRising_instance "EdgeRising detects a rising edge of the logical input signal."
 /begin REF_MEASUREMENT VehicleModel.VehicelDynamicModel.Vehicle0.EdgeRising_instance.buffer VehicleModel.VehicelDynamicModel.Vehicle0.EdgeRising_instance.oldSignal /end REF_MEASUREMENT
/end GROUP
/begin GROUP VehicleModel.VehicelDynamicModel.Vehicle0.Hysteresis_Delta_RSP_instance "Hysteresis-Delta-RSP is a hysteresis with a right switching point and a delta offset"
 /begin REF_MEASUREMENT VehicleModel.VehicelDynamicModel.Vehicle0.Hysteresis_Delta_RSP_instance.hysterese /end REF_MEASUREMENT
/end GROUP
/begin GROUP VehicleModel.VehicelDynamicModel.Vehicle0.IntegratorK_instance "IntegratorK is a time discrete integrator with gain constant K."
 /begin REF_MEASUREMENT VehicleModel.VehicelDynamicModel.Vehicle0.IntegratorK_instance.memory /end REF_MEASUREMENT
/end GROUP
/begin GROUP VehicleModel.VehicelDynamicModel.Vehicle0.VehicleDynamicModelClass_instance ""
 /begin REF_CHARACTERISTIC VehicleModel.VehicelDynamicModel.Vehicle0.VehicleDynamicModelClass_instance.c_SlopePlus VehicleModel.VehicelDynamicModel.Vehicle0.VehicleDynamicModelClass_instance.BrakeForceCurve_instance VehicleModel.VehicelDynamicModel.Vehicle0.VehicleDynamicModelClass_instance.EngineForceCurve_instance VehicleModel.VehicelDynamicModel.Vehicle0.VehicleDynamicModelClass_instance.roh VehicleModel.VehicelDynamicModel.Vehicle0.VehicleDynamicModelClass_instance.cw VehicleModel.VehicelDynamicModel.Vehicle0.VehicleDynamicModelClass_instance.A VehicleModel.VehicelDynamicModel.Vehicle0.VehicleDynamicModelClass_instance.vehicle_mass VehicleModel.VehicelDynamicModel.Vehicle0.VehicleDynamicModelClass_instance.K /end REF_CHARACTERISTIC
 /begin REF_MEASUREMENT VehicleModel.VehicelDynamicModel.Vehicle0.VehicleDynamicModelClass_instance.AirResistance VehicleModel.VehicelDynamicModel.Vehicle0.VehicleDynamicModelClass_instance.BrakeForce VehicleModel.VehicelDynamicModel.Vehicle0.VehicleDynamicModelClass_instance.EngineForce VehicleModel.VehicelDynamicModel.Vehicle0.VehicleDynamicModelClass_instance.SlopeAcceleration VehicleModel.VehicelDynamicModel.Vehicle0.VehicleDynamicModelClass_instance.hold VehicleModel.VehicelDynamicModel.Vehicle0.VehicleDynamicModelClass_instance.velocity VehicleModel.VehicelDynamicModel.Vehicle0.VehicleDynamicModelClass_instance.velocity_old /end REF_MEASUREMENT
 /begin SUB_GROUP VehicleModel.VehicelDynamicModel.Vehicle0.VehicleDynamicModelClass_instance.EdgeRising_instance VehicleModel.VehicelDynamicModel.Vehicle0.VehicleDynamicModelClass_instance.IntegratorK_instance /end SUB_GROUP
/end GROUP
/begin GROUP VehicleModel.VehicelDynamicModel.Vehicle0.VehicleDynamicModelClass_instance.EdgeRising_instance "EdgeRising detects a rising edge of the logical input signal."
 /begin REF_MEASUREMENT VehicleModel.VehicelDynamicModel.Vehicle0.VehicleDynamicModelClass_instance.EdgeRising_instance.buffer VehicleModel.VehicelDynamicModel.Vehicle0.VehicleDynamicModelClass_instance.EdgeRising_instance.oldSignal /end REF_MEASUREMENT
/end GROUP
/begin GROUP VehicleModel.VehicelDynamicModel.Vehicle0.VehicleDynamicModelClass_instance.IntegratorK_instance "IntegratorK is a time discrete integrator with gain constant K."
 /begin REF_MEASUREMENT VehicleModel.VehicelDynamicModel.Vehicle0.VehicleDynamicModelClass_instance.IntegratorK_instance.memory /end REF_MEASUREMENT
/end GROUP
/begin GROUP VehicleModel.VehicelDynamicModel.Vehicle0.VehicleDynamicModelClass_instance_2 ""
 /begin REF_CHARACTERISTIC VehicleModel.VehicelDynamicModel.Vehicle0.VehicleDynamicModelClass_instance_2.c_SlopePlus VehicleModel.VehicelDynamicModel.Vehicle0.VehicleDynamicModelClass_instance_2.BrakeForceCurve_instance VehicleModel.VehicelDynamicModel.Vehicle0.VehicleDynamicModelClass_instance_2.EngineForceCurve_instance VehicleModel.VehicelDynamicModel.Vehicle0.VehicleDynamicModelClass_instance_2.roh VehicleModel.VehicelDynamicModel.Vehicle0.VehicleDynamicModelClass_instance_2.cw VehicleModel.VehicelDynamicModel.Vehicle0.VehicleDynamicModelClass_instance_2.A VehicleModel.VehicelDynamicModel.Vehicle0.VehicleDynamicModelClass_instance_2.vehicle_mass VehicleModel.VehicelDynamicModel.Vehicle0.VehicleDynamicModelClass_instance_2.K /end REF_CHARACTERISTIC
 /begin REF_MEASUREMENT VehicleModel.VehicelDynamicModel.Vehicle0.VehicleDynamicModelClass_instance_2.AirResistance VehicleModel.VehicelDynamicModel.Vehicle0.VehicleDynamicModelClass_instance_2.BrakeForce VehicleModel.VehicelDynamicModel.Vehicle0.VehicleDynamicModelClass_instance_2.EngineForce VehicleModel.VehicelDynamicModel.Vehicle0.VehicleDynamicModelClass_instance_2.SlopeAcceleration VehicleModel.VehicelDynamicModel.Vehicle0.VehicleDynamicModelClass_instance_2.hold VehicleModel.VehicelDynamicModel.Vehicle0.VehicleDynamicModelClass_instance_2.velocity VehicleModel.VehicelDynamicModel.Vehicle0.VehicleDynamicModelClass_instance_2.velocity_old /end REF_MEASUREMENT
 /begin SUB_GROUP VehicleModel.VehicelDynamicModel.Vehicle0.VehicleDynamicModelClass_instance_2.EdgeRising_instance VehicleModel.VehicelDynamicModel.Vehicle0.VehicleDynamicModelClass_instance_2.IntegratorK_instance /end SUB_GROUP
/end GROUP
/begin GROUP VehicleModel.VehicelDynamicModel.Vehicle0.VehicleDynamicModelClass_instance_2.EdgeRising_instance "EdgeRising detects a rising edge of the logical input signal."
 /begin REF_MEASUREMENT VehicleModel.VehicelDynamicModel.Vehicle0.VehicleDynamicModelClass_instance_2.EdgeRising_instance.buffer VehicleModel.VehicelDynamicModel.Vehicle0.VehicleDynamicModelClass_instance_2.EdgeRising_instance.oldSignal /end REF_MEASUREMENT
/end GROUP
/begin GROUP VehicleModel.VehicelDynamicModel.Vehicle0.VehicleDynamicModelClass_instance_2.IntegratorK_instance "IntegratorK is a time discrete integrator with gain constant K."
 /begin REF_MEASUREMENT VehicleModel.VehicelDynamicModel.Vehicle0.VehicleDynamicModelClass_instance_2.IntegratorK_instance.memory /end REF_MEASUREMENT
/end GROUP
/begin GROUP interfaces.messages "" ROOT
 /begin REF_MEASUREMENT interfaces.messages.Acceleration_EC interfaces.messages.Actual_Position_EC interfaces.messages.Actual_Position_LC interfaces.messages.Actual_Velocity_EC interfaces.messages.Actual_Velocity_LC interfaces.messages.Relative_Distance interfaces.messages.Relative_Velocity interfaces.messages.Safe_Distance interfaces.messages.Set_Velocity /end REF_MEASUREMENT
/end GROUP
/end MODULE
/end PROJECT
