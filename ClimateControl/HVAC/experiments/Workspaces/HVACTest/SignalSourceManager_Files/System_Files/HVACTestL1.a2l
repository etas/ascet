ASAP2_VERSION 1 41
/begin PROJECT HVACTest "Generated by ETAS from Project HVACTest"
/begin HEADER "" VERSION "000" PROJECT_NO ASD /end HEADER
/begin MODULE HVACTest "Generated by ETAS ASCET7 from Project: HVACTest"
/begin IF_DATA E_TARGET
 /begin SOURCE "Task0" 3 /* period */ 10 QP_BLOB 1 /end SOURCE
 /begin TP_BLOB /* programm id */ 889712768 /* target id */ 7 0 2 0 /end TP_BLOB
/end IF_DATA
/begin MOD_PAR "" VERSION "000" ADDR_EPK 0x0 EPK "" SUPPLIER "ETAS GmbH" CUSTOMER "xxx" CUSTOMER_NO "000" USER "xxx" PHONE_NO "000" ECU "PC" CPU_TYPE "PCx86" NO_OF_INTERFACES 1 /end MOD_PAR
/begin MOD_COMMON "Common definitions" BYTE_ORDER MSB_LAST ALIGNMENT_BYTE 1 ALIGNMENT_WORD 2 ALIGNMENT_LONG 4 ALIGNMENT_FLOAT32_IEEE 4 ALIGNMENT_FLOAT64_IEEE 8 /end MOD_COMMON
/begin CHARACTERISTIC System.HVACTest.Sti_T_Environment "" VALUE 0x0 STANDARD_VALUE_R32 0.0 esdl_ident -3.4028234663852886E+38 3.4028234663852886E+38 /end CHARACTERISTIC
/begin CHARACTERISTIC System.HVACTest.Sti_T_Setpoint "" VALUE 0x0 STANDARD_VALUE_R32 0.0 esdl_ident -3.4028234663852886E+38 3.4028234663852886E+38 /end CHARACTERISTIC
/begin CHARACTERISTIC System.HVACTest.Sti_VentilationSetpoint "" VALUE 0x0 STANDARD_VALUE_U8 0.0 esdl_System_OnOffSwitch 0 3 /end CHARACTERISTIC
/begin MEASUREMENT System.HVAC.temperatureRequest "" UBYTE esdl_System_Scode_ET_Request_TemperatureEnum 1 100.0 1 2 ECU_ADDRESS 0x0 /end MEASUREMENT
/begin MEASUREMENT System.HVAC.ventilationRequest "" UBYTE esdl_System_Scode_ET_Request_VentilationEnum 1 100.0 1 3 ECU_ADDRESS 0x0 /end MEASUREMENT
/begin MEASUREMENT System.HVAC.modeSelector_instance.sm "" UBYTE esdl_System_Scode_modeSelectorSMStates 1 100.0 0 3 ECU_ADDRESS 0x0 /end MEASUREMENT
/begin MEASUREMENT System.HVAC.modeSelector_instance.ET_Request_Ventilation "" UBYTE esdl_System_Scode_ET_Request_VentilationEnum 1 100.0 1 3 ECU_ADDRESS 0x0 /end MEASUREMENT
/begin MEASUREMENT System.HVAC.modeSelector_instance.ET_Request_Temperature "" UBYTE esdl_System_Scode_ET_Request_TemperatureEnum 1 100.0 1 2 ECU_ADDRESS 0x0 /end MEASUREMENT
/begin MEASUREMENT System.HVAC.modeSelector_instance.currentMode "" UBYTE esdl_System_Scode_ModesEnum 1 100.0 1 4 ECU_ADDRESS 0x0 /end MEASUREMENT
/begin MEASUREMENT System.HVAC.mode "" UBYTE esdl_System_Scode_ModesEnum 1 100.0 1 4 ECU_ADDRESS 0x0 /end MEASUREMENT
/begin MEASUREMENT System.HVAC.rateVentilationCooler "" FLOAT32_IEEE esdl_ident 1 100.0 -3.4028234663852886E+38 3.4028234663852886E+38 ECU_ADDRESS 0x0 /end MEASUREMENT
/begin MEASUREMENT System.HVAC.rateVentilationHeater "" FLOAT32_IEEE esdl_ident 1 100.0 -3.4028234663852886E+38 3.4028234663852886E+38 ECU_ADDRESS 0x0 /end MEASUREMENT
/begin MEASUREMENT System.HVAC.InteriorModel_c_AC_instance.T_env "" FLOAT32_IEEE esdl_ident 1 100.0 -3.4028234663852886E+38 3.4028234663852886E+38 ECU_ADDRESS 0x0 /end MEASUREMENT
/begin MEASUREMENT System.HVAC.InteriorModel_c_AC_instance.Q_int "" FLOAT32_IEEE esdl_ident 1 100.0 -3.4028234663852886E+38 3.4028234663852886E+38 ECU_ADDRESS 0x0 /end MEASUREMENT
/begin MEASUREMENT System.HVAC.InteriorModel_c_AC_instance.Q_env "" FLOAT32_IEEE esdl_ident 1 100.0 -3.4028234663852886E+38 3.4028234663852886E+38 ECU_ADDRESS 0x0 /end MEASUREMENT
/begin MEASUREMENT System.HVAC.InteriorModel_c_AC_instance.Q_heater "" FLOAT32_IEEE esdl_ident 1 100.0 -3.4028234663852886E+38 3.4028234663852886E+38 ECU_ADDRESS 0x0 /end MEASUREMENT
/begin MEASUREMENT System.HVAC.InteriorModel_c_AC_instance.Q_cooler "" FLOAT32_IEEE esdl_ident 1 100.0 -3.4028234663852886E+38 3.4028234663852886E+38 ECU_ADDRESS 0x0 /end MEASUREMENT
/begin MEASUREMENT System.HVAC.InteriorModel_c_AC_instance.rate_heater "" FLOAT32_IEEE esdl_ident 1 100.0 -3.4028234663852886E+38 3.4028234663852886E+38 ECU_ADDRESS 0x0 /end MEASUREMENT
/begin MEASUREMENT System.HVAC.InteriorModel_c_AC_instance.rate_cooler "" FLOAT32_IEEE esdl_ident 1 100.0 -3.4028234663852886E+38 3.4028234663852886E+38 ECU_ADDRESS 0x0 /end MEASUREMENT
/begin MEASUREMENT System.HVAC.InteriorModel_c_AC_instance.T_set "" FLOAT32_IEEE esdl_ident 1 100.0 -3.4028234663852886E+38 3.4028234663852886E+38 ECU_ADDRESS 0x0 /end MEASUREMENT
/begin MEASUREMENT System.HVAC.InteriorModel_c_AC_instance.cooler_active "" FLOAT32_IEEE esdl_ident 1 100.0 -3.4028234663852886E+38 3.4028234663852886E+38 ECU_ADDRESS 0x0 /end MEASUREMENT
/begin MEASUREMENT System.HVAC.InteriorModel_c_AC_instance.heater_active "" FLOAT32_IEEE esdl_ident 1 100.0 -3.4028234663852886E+38 3.4028234663852886E+38 ECU_ADDRESS 0x0 /end MEASUREMENT
/begin CHARACTERISTIC System.HVAC.InteriorModel_c_AC_instance.isolation "" VALUE 0x0 STANDARD_VALUE_R32 0.0 esdl_ident -3.4028234663852886E+38 3.4028234663852886E+38 /end CHARACTERISTIC
/begin CHARACTERISTIC System.HVAC.InteriorModel_c_AC_instance.T_heater "" VALUE 0x0 STANDARD_VALUE_R32 0.0 esdl_ident -3.4028234663852886E+38 3.4028234663852886E+38 /end CHARACTERISTIC
/begin CHARACTERISTIC System.HVAC.InteriorModel_c_AC_instance.T_cooler "" VALUE 0x0 STANDARD_VALUE_R32 0.0 esdl_ident -3.4028234663852886E+38 3.4028234663852886E+38 /end CHARACTERISTIC
/begin MEASUREMENT System.HVAC.InteriorModel_c_AC_instance.ControllerHeater.P "" FLOAT32_IEEE esdl_ident 1 100.0 -3.4028234663852886E+38 3.4028234663852886E+38 ECU_ADDRESS 0x0 /end MEASUREMENT
/begin MEASUREMENT System.HVAC.InteriorModel_c_AC_instance.ControllerHeater.I "" FLOAT32_IEEE esdl_ident 1 100.0 -3.4028234663852886E+38 3.4028234663852886E+38 ECU_ADDRESS 0x0 /end MEASUREMENT
/begin MEASUREMENT System.HVAC.InteriorModel_c_AC_instance.ControllerHeater.difference "" FLOAT32_IEEE esdl_ident 1 100.0 -3.4028234663852886E+38 3.4028234663852886E+38 ECU_ADDRESS 0x0 /end MEASUREMENT
/begin MEASUREMENT System.HVAC.InteriorModel_c_AC_instance.ControllerHeater.difference_dot "" FLOAT32_IEEE esdl_ident 1 100.0 -3.4028234663852886E+38 3.4028234663852886E+38 ECU_ADDRESS 0x0 /end MEASUREMENT
/begin MEASUREMENT System.HVAC.InteriorModel_c_AC_instance.ControllerCooler.P "" FLOAT32_IEEE esdl_ident 1 100.0 -3.4028234663852886E+38 3.4028234663852886E+38 ECU_ADDRESS 0x0 /end MEASUREMENT
/begin MEASUREMENT System.HVAC.InteriorModel_c_AC_instance.ControllerCooler.I "" FLOAT32_IEEE esdl_ident 1 100.0 -3.4028234663852886E+38 3.4028234663852886E+38 ECU_ADDRESS 0x0 /end MEASUREMENT
/begin MEASUREMENT System.HVAC.InteriorModel_c_AC_instance.ControllerCooler.difference "" FLOAT32_IEEE esdl_ident 1 100.0 -3.4028234663852886E+38 3.4028234663852886E+38 ECU_ADDRESS 0x0 /end MEASUREMENT
/begin MEASUREMENT System.HVAC.InteriorModel_c_AC_instance.ControllerCooler.difference_dot "" FLOAT32_IEEE esdl_ident 1 100.0 -3.4028234663852886E+38 3.4028234663852886E+38 ECU_ADDRESS 0x0 /end MEASUREMENT
/begin MEASUREMENT System.HVAC.InteriorModel_c_Heat_instance.T_env "" FLOAT32_IEEE esdl_ident 1 100.0 -3.4028234663852886E+38 3.4028234663852886E+38 ECU_ADDRESS 0x0 /end MEASUREMENT
/begin MEASUREMENT System.HVAC.InteriorModel_c_Heat_instance.Q_int "" FLOAT32_IEEE esdl_ident 1 100.0 -3.4028234663852886E+38 3.4028234663852886E+38 ECU_ADDRESS 0x0 /end MEASUREMENT
/begin MEASUREMENT System.HVAC.InteriorModel_c_Heat_instance.Q_env "" FLOAT32_IEEE esdl_ident 1 100.0 -3.4028234663852886E+38 3.4028234663852886E+38 ECU_ADDRESS 0x0 /end MEASUREMENT
/begin MEASUREMENT System.HVAC.InteriorModel_c_Heat_instance.Q_heater "" FLOAT32_IEEE esdl_ident 1 100.0 -3.4028234663852886E+38 3.4028234663852886E+38 ECU_ADDRESS 0x0 /end MEASUREMENT
/begin MEASUREMENT System.HVAC.InteriorModel_c_Heat_instance.Q_cooler "" FLOAT32_IEEE esdl_ident 1 100.0 -3.4028234663852886E+38 3.4028234663852886E+38 ECU_ADDRESS 0x0 /end MEASUREMENT
/begin MEASUREMENT System.HVAC.InteriorModel_c_Heat_instance.rate_heater "" FLOAT32_IEEE esdl_ident 1 100.0 -3.4028234663852886E+38 3.4028234663852886E+38 ECU_ADDRESS 0x0 /end MEASUREMENT
/begin MEASUREMENT System.HVAC.InteriorModel_c_Heat_instance.rate_cooler "" FLOAT32_IEEE esdl_ident 1 100.0 -3.4028234663852886E+38 3.4028234663852886E+38 ECU_ADDRESS 0x0 /end MEASUREMENT
/begin MEASUREMENT System.HVAC.InteriorModel_c_Heat_instance.T_set "" FLOAT32_IEEE esdl_ident 1 100.0 -3.4028234663852886E+38 3.4028234663852886E+38 ECU_ADDRESS 0x0 /end MEASUREMENT
/begin MEASUREMENT System.HVAC.InteriorModel_c_Heat_instance.cooler_active "" FLOAT32_IEEE esdl_ident 1 100.0 -3.4028234663852886E+38 3.4028234663852886E+38 ECU_ADDRESS 0x0 /end MEASUREMENT
/begin MEASUREMENT System.HVAC.InteriorModel_c_Heat_instance.heater_active "" FLOAT32_IEEE esdl_ident 1 100.0 -3.4028234663852886E+38 3.4028234663852886E+38 ECU_ADDRESS 0x0 /end MEASUREMENT
/begin CHARACTERISTIC System.HVAC.InteriorModel_c_Heat_instance.isolation "" VALUE 0x0 STANDARD_VALUE_R32 0.0 esdl_ident -3.4028234663852886E+38 3.4028234663852886E+38 /end CHARACTERISTIC
/begin CHARACTERISTIC System.HVAC.InteriorModel_c_Heat_instance.T_heater "" VALUE 0x0 STANDARD_VALUE_R32 0.0 esdl_ident -3.4028234663852886E+38 3.4028234663852886E+38 /end CHARACTERISTIC
/begin CHARACTERISTIC System.HVAC.InteriorModel_c_Heat_instance.T_cooler "" VALUE 0x0 STANDARD_VALUE_R32 0.0 esdl_ident -3.4028234663852886E+38 3.4028234663852886E+38 /end CHARACTERISTIC
/begin MEASUREMENT System.HVAC.InteriorModel_c_Heat_instance.ControllerHeater.P "" FLOAT32_IEEE esdl_ident 1 100.0 -3.4028234663852886E+38 3.4028234663852886E+38 ECU_ADDRESS 0x0 /end MEASUREMENT
/begin MEASUREMENT System.HVAC.InteriorModel_c_Heat_instance.ControllerHeater.I "" FLOAT32_IEEE esdl_ident 1 100.0 -3.4028234663852886E+38 3.4028234663852886E+38 ECU_ADDRESS 0x0 /end MEASUREMENT
/begin MEASUREMENT System.HVAC.InteriorModel_c_Heat_instance.ControllerHeater.difference "" FLOAT32_IEEE esdl_ident 1 100.0 -3.4028234663852886E+38 3.4028234663852886E+38 ECU_ADDRESS 0x0 /end MEASUREMENT
/begin MEASUREMENT System.HVAC.InteriorModel_c_Heat_instance.ControllerHeater.difference_dot "" FLOAT32_IEEE esdl_ident 1 100.0 -3.4028234663852886E+38 3.4028234663852886E+38 ECU_ADDRESS 0x0 /end MEASUREMENT
/begin MEASUREMENT System.HVAC.InteriorModel_c_Heat_instance.ControllerCooler.P "" FLOAT32_IEEE esdl_ident 1 100.0 -3.4028234663852886E+38 3.4028234663852886E+38 ECU_ADDRESS 0x0 /end MEASUREMENT
/begin MEASUREMENT System.HVAC.InteriorModel_c_Heat_instance.ControllerCooler.I "" FLOAT32_IEEE esdl_ident 1 100.0 -3.4028234663852886E+38 3.4028234663852886E+38 ECU_ADDRESS 0x0 /end MEASUREMENT
/begin MEASUREMENT System.HVAC.InteriorModel_c_Heat_instance.ControllerCooler.difference "" FLOAT32_IEEE esdl_ident 1 100.0 -3.4028234663852886E+38 3.4028234663852886E+38 ECU_ADDRESS 0x0 /end MEASUREMENT
/begin MEASUREMENT System.HVAC.InteriorModel_c_Heat_instance.ControllerCooler.difference_dot "" FLOAT32_IEEE esdl_ident 1 100.0 -3.4028234663852886E+38 3.4028234663852886E+38 ECU_ADDRESS 0x0 /end MEASUREMENT
/begin MEASUREMENT System.Congra.C_T_int.T_int "" FLOAT32_IEEE esdl_ident 1 100.0 -3.4028234663852886E+38 3.4028234663852886E+38 ECU_ADDRESS 0x0 /end MEASUREMENT
/begin MEASUREMENT System.HVAC_Interface.T_Environment "" FLOAT32_IEEE esdl_ident 1 100.0 -3.4028234663852886E+38 3.4028234663852886E+38 ECU_ADDRESS 0x0 /end MEASUREMENT
/begin MEASUREMENT System.HVAC_Interface.T_Setpoint "" FLOAT32_IEEE esdl_ident 1 100.0 -3.4028234663852886E+38 3.4028234663852886E+38 ECU_ADDRESS 0x0 /end MEASUREMENT
/begin MEASUREMENT System.HVAC_Interface.VentilationSetpoint "" UBYTE esdl_System_OnOffSwitch 1 100.0 0 3 ECU_ADDRESS 0x0 /end MEASUREMENT
/begin MEASUREMENT System.HVAC_Interface.R_Ventilation "" FLOAT32_IEEE esdl_ident 1 100.0 0.0 1.0 ECU_ADDRESS 0x0 /end MEASUREMENT
/begin MEASUREMENT System.HVAC_Interface.b_Cooler "" UBYTE esdl_ident 1 100.0 0 1 ECU_ADDRESS 0x0 BIT_MASK 0x1 /end MEASUREMENT
/begin MEASUREMENT System.HVAC_Interface.b_Heater "" UBYTE esdl_ident 1 100.0 0 1 ECU_ADDRESS 0x0 BIT_MASK 0x1 /end MEASUREMENT
/begin COMPU_METHOD esdl_System_OnOffSwitch "" TAB_VERB "%12.4" "" COMPU_TAB_REF esdl_System_OnOffSwitch_vtab /end COMPU_METHOD
/begin COMPU_VTAB esdl_System_OnOffSwitch_vtab "" TAB_VERB 4 0 "Off" 1 "On" 2 "Automatic" 3 "Manual" DEFAULT_VALUE "Error" /end COMPU_VTAB
/begin COMPU_METHOD esdl_System_Scode_ET_Request_TemperatureEnum "" TAB_VERB "%12.4" "" COMPU_TAB_REF esdl_System_Scode_ET_Request_TemperatureEnum_vtab /end COMPU_METHOD
/begin COMPU_VTAB esdl_System_Scode_ET_Request_TemperatureEnum_vtab "" TAB_VERB 2 1 "ET_Below_Outside" 2 "ET_Above_Outside" DEFAULT_VALUE "Error" /end COMPU_VTAB
/begin COMPU_METHOD esdl_System_Scode_ET_Request_VentilationEnum "" TAB_VERB "%12.4" "" COMPU_TAB_REF esdl_System_Scode_ET_Request_VentilationEnum_vtab /end COMPU_METHOD
/begin COMPU_VTAB esdl_System_Scode_ET_Request_VentilationEnum_vtab "" TAB_VERB 3 1 "ET_Off" 2 "ET_Automatic" 3 "ET_Max" DEFAULT_VALUE "Error" /end COMPU_VTAB
/begin COMPU_METHOD esdl_System_Scode_ModesEnum "" TAB_VERB "%12.4" "" COMPU_TAB_REF esdl_System_Scode_ModesEnum_vtab /end COMPU_METHOD
/begin COMPU_VTAB esdl_System_Scode_ModesEnum_vtab "" TAB_VERB 4 1 "ET_Controlled_Heating" 2 "ET_Controlled_Cooling" 3 "ET_Uncontrolled" 4 "ET_System_Off" DEFAULT_VALUE "Error" /end COMPU_VTAB
/begin COMPU_METHOD esdl_System_Scode_modeSelectorSMStates "" TAB_VERB "%12.4" "" COMPU_TAB_REF esdl_System_Scode_modeSelectorSMStates_vtab /end COMPU_METHOD
/begin COMPU_VTAB esdl_System_Scode_modeSelectorSMStates_vtab "" TAB_VERB 4 2 "ET_Controlled_Heating" 1 "ET_Controlled_Cooling" 3 "ET_Uncontrolled" 0 "ET_System_Off" DEFAULT_VALUE "Error" /end COMPU_VTAB
/begin COMPU_METHOD esdl_ident "" RAT_FUNC "%12.4" "" /* coeffs */ COEFFS 0 1 0 0 0 1 /end COMPU_METHOD
/begin FUNCTION System.HVACTest ""
 /begin DEF_CHARACTERISTIC System.HVACTest.Sti_T_Environment System.HVACTest.Sti_T_Setpoint System.HVACTest.Sti_VentilationSetpoint /end DEF_CHARACTERISTIC
 /begin OUT_MEASUREMENT System.HVAC_Interface.T_Environment System.HVAC_Interface.T_Setpoint System.HVAC_Interface.VentilationSetpoint /end OUT_MEASUREMENT
/end FUNCTION
/begin FUNCTION System.HVAC "This class implements a heating, ventilation and air conditioning controller. <ul> <li>input <b>T_Environment</b>: environment temperature</li> <li>input <b>T_Setpoint</b>: desire temperature inside the vehicle</li> <li>input <b>VentilationSetpoint</b>: c"
 /begin IN_MEASUREMENT System.HVAC_Interface.T_Environment System.HVAC_Interface.T_Setpoint System.HVAC_Interface.VentilationSetpoint /end IN_MEASUREMENT
 /begin OUT_MEASUREMENT System.HVAC_Interface.R_Ventilation System.HVAC_Interface.b_Cooler System.HVAC_Interface.b_Heater /end OUT_MEASUREMENT
 /begin LOC_MEASUREMENT System.HVAC.mode System.HVAC.rateVentilationCooler System.HVAC.rateVentilationHeater System.HVAC.temperatureRequest System.HVAC.ventilationRequest /end LOC_MEASUREMENT
 /begin SUB_FUNCTION System.HVAC.modeSelector_instance System.HVAC.InteriorModel_c_AC_instance System.HVAC.InteriorModel_c_Heat_instance /end SUB_FUNCTION
/end FUNCTION
/begin FUNCTION System.HVAC.modeSelector_instance ""
 /begin LOC_MEASUREMENT System.HVAC.modeSelector_instance.ET_Request_Temperature System.HVAC.modeSelector_instance.ET_Request_Ventilation System.HVAC.modeSelector_instance.currentMode System.HVAC.modeSelector_instance.sm /end LOC_MEASUREMENT
/end FUNCTION
/begin FUNCTION System.HVAC.InteriorModel_c_AC_instance "Esdl /resource/Example/src-gen/System/AC.syq for the system InteriorModel_c_AC Source File Path: class"
 /begin DEF_CHARACTERISTIC System.HVAC.InteriorModel_c_AC_instance.isolation System.HVAC.InteriorModel_c_AC_instance.T_heater System.HVAC.InteriorModel_c_AC_instance.T_cooler /end DEF_CHARACTERISTIC
 /begin LOC_MEASUREMENT System.HVAC.InteriorModel_c_AC_instance.Q_cooler System.HVAC.InteriorModel_c_AC_instance.Q_env System.HVAC.InteriorModel_c_AC_instance.Q_heater System.HVAC.InteriorModel_c_AC_instance.Q_int System.HVAC.InteriorModel_c_AC_instance.T_env System.HVAC.InteriorModel_c_AC_instance.T_set System.HVAC.InteriorModel_c_AC_instance.cooler_active System.HVAC.InteriorModel_c_AC_instance.heater_active System.HVAC.InteriorModel_c_AC_instance.rate_cooler System.HVAC.InteriorModel_c_AC_instance.rate_heater /end LOC_MEASUREMENT
 /begin SUB_FUNCTION System.HVAC.InteriorModel_c_AC_instance.ControllerHeater System.HVAC.InteriorModel_c_AC_instance.ControllerCooler /end SUB_FUNCTION
/end FUNCTION
/begin FUNCTION System.HVAC.InteriorModel_c_AC_instance.ControllerHeater "Esdl /resource/Example/System/SystemModel.syq for the system PIController Source File Path: struct type"
 /begin LOC_MEASUREMENT System.HVAC.InteriorModel_c_AC_instance.ControllerHeater.I System.HVAC.InteriorModel_c_AC_instance.ControllerHeater.P System.HVAC.InteriorModel_c_AC_instance.ControllerHeater.difference System.HVAC.InteriorModel_c_AC_instance.ControllerHeater.difference_dot /end LOC_MEASUREMENT
/end FUNCTION
/begin FUNCTION System.HVAC.InteriorModel_c_AC_instance.ControllerCooler "Esdl /resource/Example/System/SystemModel.syq for the system PIController Source File Path: struct type"
 /begin LOC_MEASUREMENT System.HVAC.InteriorModel_c_AC_instance.ControllerCooler.I System.HVAC.InteriorModel_c_AC_instance.ControllerCooler.P System.HVAC.InteriorModel_c_AC_instance.ControllerCooler.difference System.HVAC.InteriorModel_c_AC_instance.ControllerCooler.difference_dot /end LOC_MEASUREMENT
/end FUNCTION
/begin FUNCTION System.HVAC.InteriorModel_c_Heat_instance "Esdl /resource/Example/src-gen/System/Heat.syq for the system InteriorModel_c_Heat Source File Path: class"
 /begin DEF_CHARACTERISTIC System.HVAC.InteriorModel_c_Heat_instance.isolation System.HVAC.InteriorModel_c_Heat_instance.T_heater System.HVAC.InteriorModel_c_Heat_instance.T_cooler /end DEF_CHARACTERISTIC
 /begin LOC_MEASUREMENT System.HVAC.InteriorModel_c_Heat_instance.Q_cooler System.HVAC.InteriorModel_c_Heat_instance.Q_env System.HVAC.InteriorModel_c_Heat_instance.Q_heater System.HVAC.InteriorModel_c_Heat_instance.Q_int System.HVAC.InteriorModel_c_Heat_instance.T_env System.HVAC.InteriorModel_c_Heat_instance.T_set System.HVAC.InteriorModel_c_Heat_instance.cooler_active System.HVAC.InteriorModel_c_Heat_instance.heater_active System.HVAC.InteriorModel_c_Heat_instance.rate_cooler System.HVAC.InteriorModel_c_Heat_instance.rate_heater /end LOC_MEASUREMENT
 /begin SUB_FUNCTION System.HVAC.InteriorModel_c_Heat_instance.ControllerHeater System.HVAC.InteriorModel_c_Heat_instance.ControllerCooler /end SUB_FUNCTION
/end FUNCTION
/begin FUNCTION System.HVAC.InteriorModel_c_Heat_instance.ControllerHeater "Esdl /resource/Example/System/SystemModel.syq for the system PIController Source File Path: struct type"
 /begin LOC_MEASUREMENT System.HVAC.InteriorModel_c_Heat_instance.ControllerHeater.I System.HVAC.InteriorModel_c_Heat_instance.ControllerHeater.P System.HVAC.InteriorModel_c_Heat_instance.ControllerHeater.difference System.HVAC.InteriorModel_c_Heat_instance.ControllerHeater.difference_dot /end LOC_MEASUREMENT
/end FUNCTION
/begin FUNCTION System.HVAC.InteriorModel_c_Heat_instance.ControllerCooler "Esdl /resource/Example/System/SystemModel.syq for the system PIController Source File Path: struct type"
 /begin LOC_MEASUREMENT System.HVAC.InteriorModel_c_Heat_instance.ControllerCooler.I System.HVAC.InteriorModel_c_Heat_instance.ControllerCooler.P System.HVAC.InteriorModel_c_Heat_instance.ControllerCooler.difference System.HVAC.InteriorModel_c_Heat_instance.ControllerCooler.difference_dot /end LOC_MEASUREMENT
/end FUNCTION
/begin FUNCTION System.Congra.C_T_int "" /end FUNCTION
/begin RECORD_LAYOUT STANDARD_VALUE_R32 /* value */ FNC_VALUES 1 FLOAT32_IEEE COLUMN_DIR DIRECT /end RECORD_LAYOUT
/begin RECORD_LAYOUT STANDARD_VALUE_U8 /* value */ FNC_VALUES 1 UBYTE COLUMN_DIR DIRECT /end RECORD_LAYOUT
/begin GROUP System.Congra.C_T_int "" ROOT /begin REF_MEASUREMENT System.Congra.C_T_int.T_int /end REF_MEASUREMENT /end GROUP
/begin GROUP System.HVAC "This class implements a heating, ventilation and air conditioning controller. <ul> <li>input <b>T_Environment</b>: environment temperature</li> <li>input <b>T_Setpoint</b>: desire temperature inside the vehicle</li> <li>input <b>VentilationSetpoint</b>: c" ROOT
 /begin REF_MEASUREMENT System.HVAC.mode System.HVAC.rateVentilationCooler System.HVAC.rateVentilationHeater System.HVAC.temperatureRequest System.HVAC.ventilationRequest /end REF_MEASUREMENT
 /begin SUB_GROUP System.HVAC.modeSelector_instance System.HVAC.InteriorModel_c_AC_instance System.HVAC.InteriorModel_c_Heat_instance /end SUB_GROUP
/end GROUP
/begin GROUP System.HVAC.InteriorModel_c_AC_instance "Esdl /resource/Example/src-gen/System/AC.syq for the system InteriorModel_c_AC Source File Path: class"
 /begin REF_CHARACTERISTIC System.HVAC.InteriorModel_c_AC_instance.isolation System.HVAC.InteriorModel_c_AC_instance.T_heater System.HVAC.InteriorModel_c_AC_instance.T_cooler /end REF_CHARACTERISTIC
 /begin REF_MEASUREMENT System.HVAC.InteriorModel_c_AC_instance.Q_cooler System.HVAC.InteriorModel_c_AC_instance.Q_env System.HVAC.InteriorModel_c_AC_instance.Q_heater System.HVAC.InteriorModel_c_AC_instance.Q_int System.HVAC.InteriorModel_c_AC_instance.T_env System.HVAC.InteriorModel_c_AC_instance.T_set System.HVAC.InteriorModel_c_AC_instance.cooler_active System.HVAC.InteriorModel_c_AC_instance.heater_active System.HVAC.InteriorModel_c_AC_instance.rate_cooler System.HVAC.InteriorModel_c_AC_instance.rate_heater /end REF_MEASUREMENT
 /begin SUB_GROUP System.HVAC.InteriorModel_c_AC_instance.ControllerHeater System.HVAC.InteriorModel_c_AC_instance.ControllerCooler /end SUB_GROUP
/end GROUP
/begin GROUP System.HVAC.InteriorModel_c_AC_instance.ControllerCooler "Esdl /resource/Example/System/SystemModel.syq for the system PIController Source File Path: struct type"
 /begin REF_MEASUREMENT System.HVAC.InteriorModel_c_AC_instance.ControllerCooler.I System.HVAC.InteriorModel_c_AC_instance.ControllerCooler.P System.HVAC.InteriorModel_c_AC_instance.ControllerCooler.difference System.HVAC.InteriorModel_c_AC_instance.ControllerCooler.difference_dot /end REF_MEASUREMENT
/end GROUP
/begin GROUP System.HVAC.InteriorModel_c_AC_instance.ControllerHeater "Esdl /resource/Example/System/SystemModel.syq for the system PIController Source File Path: struct type"
 /begin REF_MEASUREMENT System.HVAC.InteriorModel_c_AC_instance.ControllerHeater.I System.HVAC.InteriorModel_c_AC_instance.ControllerHeater.P System.HVAC.InteriorModel_c_AC_instance.ControllerHeater.difference System.HVAC.InteriorModel_c_AC_instance.ControllerHeater.difference_dot /end REF_MEASUREMENT
/end GROUP
/begin GROUP System.HVAC.InteriorModel_c_Heat_instance "Esdl /resource/Example/src-gen/System/Heat.syq for the system InteriorModel_c_Heat Source File Path: class"
 /begin REF_CHARACTERISTIC System.HVAC.InteriorModel_c_Heat_instance.isolation System.HVAC.InteriorModel_c_Heat_instance.T_heater System.HVAC.InteriorModel_c_Heat_instance.T_cooler /end REF_CHARACTERISTIC
 /begin REF_MEASUREMENT System.HVAC.InteriorModel_c_Heat_instance.Q_cooler System.HVAC.InteriorModel_c_Heat_instance.Q_env System.HVAC.InteriorModel_c_Heat_instance.Q_heater System.HVAC.InteriorModel_c_Heat_instance.Q_int System.HVAC.InteriorModel_c_Heat_instance.T_env System.HVAC.InteriorModel_c_Heat_instance.T_set System.HVAC.InteriorModel_c_Heat_instance.cooler_active System.HVAC.InteriorModel_c_Heat_instance.heater_active System.HVAC.InteriorModel_c_Heat_instance.rate_cooler System.HVAC.InteriorModel_c_Heat_instance.rate_heater /end REF_MEASUREMENT
 /begin SUB_GROUP System.HVAC.InteriorModel_c_Heat_instance.ControllerHeater System.HVAC.InteriorModel_c_Heat_instance.ControllerCooler /end SUB_GROUP
/end GROUP
/begin GROUP System.HVAC.InteriorModel_c_Heat_instance.ControllerCooler "Esdl /resource/Example/System/SystemModel.syq for the system PIController Source File Path: struct type"
 /begin REF_MEASUREMENT System.HVAC.InteriorModel_c_Heat_instance.ControllerCooler.I System.HVAC.InteriorModel_c_Heat_instance.ControllerCooler.P System.HVAC.InteriorModel_c_Heat_instance.ControllerCooler.difference System.HVAC.InteriorModel_c_Heat_instance.ControllerCooler.difference_dot /end REF_MEASUREMENT
/end GROUP
/begin GROUP System.HVAC.InteriorModel_c_Heat_instance.ControllerHeater "Esdl /resource/Example/System/SystemModel.syq for the system PIController Source File Path: struct type"
 /begin REF_MEASUREMENT System.HVAC.InteriorModel_c_Heat_instance.ControllerHeater.I System.HVAC.InteriorModel_c_Heat_instance.ControllerHeater.P System.HVAC.InteriorModel_c_Heat_instance.ControllerHeater.difference System.HVAC.InteriorModel_c_Heat_instance.ControllerHeater.difference_dot /end REF_MEASUREMENT
/end GROUP
/begin GROUP System.HVAC.modeSelector_instance ""
 /begin REF_MEASUREMENT System.HVAC.modeSelector_instance.ET_Request_Temperature System.HVAC.modeSelector_instance.ET_Request_Ventilation System.HVAC.modeSelector_instance.currentMode System.HVAC.modeSelector_instance.sm /end REF_MEASUREMENT
/end GROUP
/begin GROUP System.HVACTest "" ROOT
 /begin REF_CHARACTERISTIC System.HVACTest.Sti_T_Environment System.HVACTest.Sti_T_Setpoint System.HVACTest.Sti_VentilationSetpoint /end REF_CHARACTERISTIC
/end GROUP
/begin GROUP System.HVAC_Interface "" ROOT
 /begin REF_MEASUREMENT System.HVAC_Interface.R_Ventilation System.HVAC_Interface.T_Environment System.HVAC_Interface.T_Setpoint System.HVAC_Interface.VentilationSetpoint System.HVAC_Interface.b_Cooler System.HVAC_Interface.b_Heater /end REF_MEASUREMENT
/end GROUP
/end MODULE
/end PROJECT
