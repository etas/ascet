ASAP2_VERSION 1 41
/begin PROJECT LightControl "Generated by ETAS from Project LightControl"
/begin HEADER "" VERSION "000" PROJECT_NO ASD /end HEADER
/begin MODULE LightControl "Generated by ETAS ASCET7 from Project: LightControl"
/begin IF_DATA E_TARGET
 /begin SOURCE "Task0" 3 /* period */ 10 QP_BLOB 1 /end SOURCE
 /begin TP_BLOB /* programm id */ 889698204 /* target id */ 7 0 2 0 /end TP_BLOB
/end IF_DATA
/begin MOD_PAR "" VERSION "000" ADDR_EPK 0x0 EPK "" SUPPLIER "ETAS GmbH" CUSTOMER "xxx" CUSTOMER_NO "000" USER "xxx" PHONE_NO "000" ECU "PC" CPU_TYPE "PCx86" NO_OF_INTERFACES 1 /end MOD_PAR
/begin MOD_COMMON "Common definitions" BYTE_ORDER MSB_LAST ALIGNMENT_BYTE 1 ALIGNMENT_WORD 2 ALIGNMENT_LONG 4 ALIGNMENT_FLOAT32_IEEE 4 ALIGNMENT_FLOAT64_IEEE 8 /end MOD_COMMON
/begin MEASUREMENT controller.LightControlTest.tester.sm "" UBYTE esdl_controller_LightsStatemachineStates 1 100.0 0 8 ECU_ADDRESS 0x0 /end MEASUREMENT
/begin MEASUREMENT controller.LightControlTest.tester.localTimer.timeCounter "" FLOAT32_IEEE esdl_ident 1 100.0 -3.4028234663852886E+38 3.4028234663852886E+38 ECU_ADDRESS 0x0 /end MEASUREMENT
/begin MEASUREMENT controller.LightControlTest.tester.errorTimer.timeCounter "" FLOAT32_IEEE esdl_ident 1 100.0 -3.4028234663852886E+38 3.4028234663852886E+38 ECU_ADDRESS 0x0 /end MEASUREMENT
/begin MEASUREMENT controller.LightControlTest.tester.error "" UBYTE esdl_ident 1 100.0 0 1 ECU_ADDRESS 0x0 BIT_MASK 0x1 /end MEASUREMENT
/begin MEASUREMENT controller.LightControlTest.tester.green "" UBYTE esdl_ident 1 100.0 0 1 ECU_ADDRESS 0x0 BIT_MASK 0x1 /end MEASUREMENT
/begin MEASUREMENT controller.LightControlTest.tester.red "" UBYTE esdl_ident 1 100.0 0 1 ECU_ADDRESS 0x0 BIT_MASK 0x1 /end MEASUREMENT
/begin MEASUREMENT controller.LightControlTest.tester.yellow "" UBYTE esdl_ident 1 100.0 0 1 ECU_ADDRESS 0x0 BIT_MASK 0x1 /end MEASUREMENT
/begin CHARACTERISTIC controller.LightControlTest.tester.GreenTime "" VALUE 0x0 STANDARD_VALUE_R32 0.0 esdl_ident -3.4028234663852886E+38 3.4028234663852886E+38 /end CHARACTERISTIC
/begin CHARACTERISTIC controller.LightControlTest.tester.RedTime "" VALUE 0x0 STANDARD_VALUE_R32 0.0 esdl_ident -3.4028234663852886E+38 3.4028234663852886E+38 /begin DEPENDENT_CHARACTERISTIC "2.0 * X1" controller.LightControlTest.tester.GreenTime /end DEPENDENT_CHARACTERISTIC /end CHARACTERISTIC
/begin CHARACTERISTIC controller.LightControlTest.tester.YellowTime "" VALUE 0x0 STANDARD_VALUE_R32 0.0 esdl_ident -3.4028234663852886E+38 3.4028234663852886E+38 /begin DEPENDENT_CHARACTERISTIC "X1 / 3.0" controller.LightControlTest.tester.GreenTime /end DEPENDENT_CHARACTERISTIC /end CHARACTERISTIC
/begin CHARACTERISTIC controller.LightControlTest.tester.BlinkTime "" VALUE 0x0 STANDARD_VALUE_R32 0.0 esdl_ident -3.4028234663852886E+38 3.4028234663852886E+38 /begin DEPENDENT_CHARACTERISTIC "X1 / 3.0" controller.LightControlTest.tester.YellowTime /end DEPENDENT_CHARACTERISTIC /end CHARACTERISTIC
/begin MEASUREMENT controller.LightControlTest.currentState_return "" UBYTE esdl_controller_LightsStatemachineStates 1 100.0 0 8 ECU_ADDRESS 0x0 /end MEASUREMENT
/begin CHARACTERISTIC controller.LightControlTest.Sti_error "" VALUE 0x0 STANDARD_VALUE_U8 0.0 esdl_ident 0 1 BIT_MASK 0x1 /end CHARACTERISTIC
/begin COMPU_METHOD esdl_controller_LightsStatemachineStates "" TAB_VERB /* format */ "%12.4" /* unit */ "" /* compu_tab_ref */ COMPU_TAB_REF esdl_controller_LightsStatemachineStates_vtab /end COMPU_METHOD
/begin COMPU_VTAB esdl_controller_LightsStatemachineStates_vtab "" TAB_VERB /* number value pairs */ 9 7 "ErrorMode" 0 "YellowOff" 6 "YellowOn" 8 "NormalMode" 3 "Red" 1 "AllOff" 5 "Yellow" 2 "Green" 4 "RedYellow" /* default value */ DEFAULT_VALUE "Error" /end COMPU_VTAB
/begin COMPU_METHOD esdl_ident "" RAT_FUNC /* format */ "%12.4" /* unit */ "" /* coeffs */ COEFFS 0 1 0 0 0 1 /end COMPU_METHOD
/begin FUNCTION controller.LightControlTest "" /begin DEF_CHARACTERISTIC controller.LightControlTest.Sti_error /end DEF_CHARACTERISTIC /begin LOC_MEASUREMENT controller.LightControlTest.currentState_return /end LOC_MEASUREMENT /begin SUB_FUNCTION controller.LightControlTest.tester /end SUB_FUNCTION /end FUNCTION
/begin FUNCTION controller.LightControlTest.tester ""
 /begin DEF_CHARACTERISTIC controller.LightControlTest.tester.GreenTime controller.LightControlTest.tester.RedTime controller.LightControlTest.tester.YellowTime controller.LightControlTest.tester.BlinkTime /end DEF_CHARACTERISTIC
 /begin LOC_MEASUREMENT controller.LightControlTest.tester.error controller.LightControlTest.tester.green controller.LightControlTest.tester.red controller.LightControlTest.tester.sm controller.LightControlTest.tester.yellow /end LOC_MEASUREMENT
 /begin SUB_FUNCTION controller.LightControlTest.tester.localTimer controller.LightControlTest.tester.errorTimer /end SUB_FUNCTION
/end FUNCTION
/begin FUNCTION controller.LightControlTest.tester.localTimer "Timer decrements the time counter by dT and signals when the time counter has reached zero." /begin LOC_MEASUREMENT controller.LightControlTest.tester.localTimer.timeCounter /end LOC_MEASUREMENT /end FUNCTION
/begin FUNCTION controller.LightControlTest.tester.errorTimer "Timer decrements the time counter by dT and signals when the time counter has reached zero." /begin LOC_MEASUREMENT controller.LightControlTest.tester.errorTimer.timeCounter /end LOC_MEASUREMENT /end FUNCTION
/begin RECORD_LAYOUT STANDARD_VALUE_R32 /* value */ FNC_VALUES 1 FLOAT32_IEEE COLUMN_DIR DIRECT /end RECORD_LAYOUT
/begin RECORD_LAYOUT STANDARD_VALUE_U8 /* value */ FNC_VALUES 1 UBYTE COLUMN_DIR DIRECT /end RECORD_LAYOUT
/begin GROUP controller.LightControlTest "" ROOT /begin REF_CHARACTERISTIC controller.LightControlTest.Sti_error /end REF_CHARACTERISTIC /begin REF_MEASUREMENT controller.LightControlTest.currentState_return /end REF_MEASUREMENT /begin SUB_GROUP controller.LightControlTest.tester /end SUB_GROUP /end GROUP
/begin GROUP controller.LightControlTest.tester ""
 /begin REF_CHARACTERISTIC controller.LightControlTest.tester.GreenTime controller.LightControlTest.tester.RedTime controller.LightControlTest.tester.YellowTime controller.LightControlTest.tester.BlinkTime /end REF_CHARACTERISTIC
 /begin REF_MEASUREMENT controller.LightControlTest.tester.error controller.LightControlTest.tester.green controller.LightControlTest.tester.red controller.LightControlTest.tester.sm controller.LightControlTest.tester.yellow /end REF_MEASUREMENT
 /begin SUB_GROUP controller.LightControlTest.tester.localTimer controller.LightControlTest.tester.errorTimer /end SUB_GROUP
/end GROUP
/begin GROUP controller.LightControlTest.tester.errorTimer "Timer decrements the time counter by dT and signals when the time counter has reached zero." /begin REF_MEASUREMENT controller.LightControlTest.tester.errorTimer.timeCounter /end REF_MEASUREMENT /end GROUP
/begin GROUP controller.LightControlTest.tester.localTimer "Timer decrements the time counter by dT and signals when the time counter has reached zero." /begin REF_MEASUREMENT controller.LightControlTest.tester.localTimer.timeCounter /end REF_MEASUREMENT /end GROUP
/end MODULE
/end PROJECT
