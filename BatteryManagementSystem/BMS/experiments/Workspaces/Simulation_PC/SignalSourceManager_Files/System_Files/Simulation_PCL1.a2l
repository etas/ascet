ASAP2_VERSION 1 41
/begin PROJECT Simulation_PC "Generated by ETAS from Project Simulation_PC"
/begin HEADER "" VERSION "000" PROJECT_NO ASD /end HEADER
/begin MODULE Simulation_PC "Generated by ETAS ASCET7 from Project: Simulation_PC"
/begin IF_DATA E_TARGET
 /begin SOURCE "Task_10ms" 3 /* period */ 10 QP_BLOB 1 /end SOURCE
 /begin TP_BLOB /* programm id */ 890310352 /* target id */ 7 0 2 0 /end TP_BLOB
/end IF_DATA
/begin MOD_PAR "" VERSION "000" ADDR_EPK 0x0 EPK "" SUPPLIER "ETAS GmbH" CUSTOMER "xxx" CUSTOMER_NO "000" USER "xxx" PHONE_NO "000" ECU "PC" CPU_TYPE "PCx86" NO_OF_INTERFACES 1 /end MOD_PAR
/begin MOD_COMMON "Common definitions" BYTE_ORDER MSB_LAST ALIGNMENT_BYTE 1 ALIGNMENT_WORD 2 ALIGNMENT_LONG 4 ALIGNMENT_FLOAT32_IEEE 4 ALIGNMENT_FLOAT64_IEEE 8 /end MOD_COMMON
/begin MEASUREMENT SOCClasses.BatteryPlantModel.PW "" FLOAT64_IEEE esdl_ident 1 100.0 -1.7976931348623157E+308 1.7976931348623157E+308 ECU_ADDRESS 0x0 /end MEASUREMENT
/begin MEASUREMENT SOCClasses.BatteryPlantModel.IntegratorK_instance_T_Cell.memory "" FLOAT64_IEEE esdl_ident 1 100.0 -1.7976931348623157E+308 1.7976931348623157E+308 ECU_ADDRESS 0x0 /end MEASUREMENT
/begin CHARACTERISTIC SOCClasses.BatteryPlantModel.C_ThermicDampCoeff "" VALUE 0x0 STANDARD_VALUE_R64 0.0 esdl_ident -1.7976931348623157E+308 1.7976931348623157E+308 /end CHARACTERISTIC
/begin CHARACTERISTIC SOCClasses.BatteryPlantModel.C_Bat "" VALUE 0x0 STANDARD_VALUE_R64 0.0 esdl_ident -1.7976931348623157E+308 1.7976931348623157E+308 /end CHARACTERISTIC
/begin CHARACTERISTIC SOCClasses.BatteryPlantModel.T0 "" VALUE 0x0 STANDARD_VALUE_R64 0.0 esdl_ident -1.7976931348623157E+308 1.7976931348623157E+308 /end CHARACTERISTIC
/begin CHARACTERISTIC SOCClasses.BatteryPlantModel.UN "Nominal voltage [V]" VALUE 0x0 STANDARD_VALUE_R64 0.0 esdl_ident -1.7976931348623157E+308 1.7976931348623157E+308 /end CHARACTERISTIC
/begin CHARACTERISTIC SOCClasses.BatteryPlantModel.K1 "cell constant [V]" VALUE 0x0 STANDARD_VALUE_R64 0.0 esdl_ident -1.7976931348623157E+308 1.7976931348623157E+308 /end CHARACTERISTIC
/begin CHARACTERISTIC SOCClasses.BatteryPlantModel.TN "Nominal temperature [°K]" VALUE 0x0 STANDARD_VALUE_R64 0.0 esdl_ident -1.7976931348623157E+308 1.7976931348623157E+308 /end CHARACTERISTIC
/begin CHARACTERISTIC SOCClasses.BatteryPlantModel.K2 "Temperature Constant [°K]" VALUE 0x0 STANDARD_VALUE_R64 0.0 esdl_ident -1.7976931348623157E+308 1.7976931348623157E+308 /end CHARACTERISTIC
/begin CHARACTERISTIC SOCClasses.BatteryPlantModel.I0 "leakage current [A]" VALUE 0x0 STANDARD_VALUE_R64 0.0 esdl_ident -1.7976931348623157E+308 1.7976931348623157E+308 /end CHARACTERISTIC
/begin CHARACTERISTIC SOCClasses.BatteryPlantModel.P0 "initial charge value [%]" VALUE 0x0 STANDARD_VALUE_R64 0.0 esdl_ident -1.7976931348623157E+308 1.7976931348623157E+308 /end CHARACTERISTIC
/begin CHARACTERISTIC SOCClasses.BatteryPlantModel.KN "nominal capacity [As]" VALUE 0x0 STANDARD_VALUE_R64 0.0 esdl_ident -1.7976931348623157E+308 1.7976931348623157E+308 /end CHARACTERISTIC
/begin MEASUREMENT SOCClasses.BatteryPlantModel.IV "leakage current [A]" FLOAT64_IEEE esdl_ident 1 100.0 -1.7976931348623157E+308 1.7976931348623157E+308 ECU_ADDRESS 0x0 /end MEASUREMENT
/begin CHARACTERISTIC SOCClasses.BatteryPlantModel.U_0 "Base voltage [V]" VALUE 0x0 STANDARD_VALUE_R64 0.0 esdl_ident -1.7976931348623157E+308 1.7976931348623157E+308 /end CHARACTERISTIC
/begin CHARACTERISTIC SOCClasses.BatteryPlantModel.R_V_0 "Internal resistance [Ohm]" VALUE 0x0 STANDARD_VALUE_R64 0.0 esdl_ident -1.7976931348623157E+308 1.7976931348623157E+308 /end CHARACTERISTIC
/begin CHARACTERISTIC SOCClasses.BatteryPlantModel.R_P "Polarisation resistance [Ohm]" VALUE 0x0 STANDARD_VALUE_R64 0.0 esdl_ident -1.7976931348623157E+308 1.7976931348623157E+308 /end CHARACTERISTIC
/begin MEASUREMENT SOCClasses.BatteryPlantModel.R_V "Leakage resistance [Ohm]" FLOAT64_IEEE esdl_ident 1 100.0 -1.7976931348623157E+308 1.7976931348623157E+308 ECU_ADDRESS 0x0 /end MEASUREMENT
/begin MEASUREMENT SOCClasses.BatteryPlantModel.IntegratorK_instance_SOC.memory "" FLOAT64_IEEE esdl_ident 1 100.0 -1.7976931348623157E+308 1.7976931348623157E+308 ECU_ADDRESS 0x0 /end MEASUREMENT
/begin CHARACTERISTIC SOCClasses.BatteryPlantModel.T_SOC_2_RV "" MAP 0x0 STANDARD_MAP_R64R64R64 0.0 esdl_ident -1.7976931348623157E+308 1.7976931348623157E+308
 /begin AXIS_DESCR STD_AXIS NO_INPUT_QUANTITY esdl_ident 12 -1.7976931348623157E+308 1.7976931348623157E+308 /end AXIS_DESCR
 /begin AXIS_DESCR STD_AXIS NO_INPUT_QUANTITY esdl_ident 8 -1.7976931348623157E+308 1.7976931348623157E+308 /end AXIS_DESCR
/end CHARACTERISTIC
/begin MEASUREMENT SOCClasses.BatteryPlantModel.IntegratorKLimited_instance.memory "" FLOAT64_IEEE esdl_ident 1 100.0 -1.7976931348623157E+308 1.7976931348623157E+308 ECU_ADDRESS 0x0 /end MEASUREMENT
/begin CHARACTERISTIC SOCClasses.SOC.accu.BaseVoltage "" VALUE 0x0 STANDARD_VALUE_R64 0.0 esdl_ident 0.0 5.0 /end CHARACTERISTIC
/begin CHARACTERISTIC SOCClasses.SOC.accu.GainVoltage "" VALUE 0x0 STANDARD_VALUE_R64 0.0 esdl_ident -1.7976931348623157E+308 1.7976931348623157E+308 /end CHARACTERISTIC
/begin CHARACTERISTIC SOCClasses.SOC.accu.GainVoltage_inv "" VALUE 0x0 STANDARD_VALUE_R64 0.0 esdl_ident -1.7976931348623157E+308 1.7976931348623157E+308
 /begin DEPENDENT_CHARACTERISTIC /* formula */ "0.1/X1" /* model paths */ SOCClasses.SOC.accu.GainVoltage /end DEPENDENT_CHARACTERISTIC
/end CHARACTERISTIC
/begin CHARACTERISTIC SOCClasses.SOC.accu.temp_curve "" CURVE 0x0 STANDARD_CURVE_R64R64 0.0 esdl_ident -1.7976931348623157E+308 1.7976931348623157E+308
 /begin AXIS_DESCR STD_AXIS NO_INPUT_QUANTITY esdl_ident 16 -1.7976931348623157E+308 1.7976931348623157E+308 /end AXIS_DESCR
/end CHARACTERISTIC
/begin MEASUREMENT SOCClasses.SOC.battState.sm "" UBYTE esdl_SOCClasses_BatteryState1StatemachineStates 1 100.0 0 4 ECU_ADDRESS 0x0 /end MEASUREMENT
/begin MEASUREMENT SOCClasses.SOC.battState.current_measure "" FLOAT64_IEEE esdl_ident 1 100.0 -1.7976931348623157E+308 1.7976931348623157E+308 ECU_ADDRESS 0x0 /end MEASUREMENT
/begin MEASUREMENT SOCClasses.SOC.battState.SOC_in "" FLOAT64_IEEE esdl_ident 1 100.0 -1.7976931348623157E+308 1.7976931348623157E+308 ECU_ADDRESS 0x0 /end MEASUREMENT
/begin MEASUREMENT SOCClasses.SOC.battState.SOC_request "" UBYTE esdl_ident 1 100.0 0 1 ECU_ADDRESS 0x0 BIT_MASK 0x1 /end MEASUREMENT
/begin MEASUREMENT SOCClasses.SOC.battState.SOC_value "" FLOAT64_IEEE esdl_ident 1 100.0 -1.7976931348623157E+308 1.7976931348623157E+308 ECU_ADDRESS 0x0 /end MEASUREMENT
/begin CHARACTERISTIC SOCClasses.SOC.battState.P_SOCCheckPeriod "" VALUE 0x0 STANDARD_VALUE_R64 0.0 esdl_ident -1.7976931348623157E+308 1.7976931348623157E+308 /end CHARACTERISTIC
/begin CHARACTERISTIC SOCClasses.SOC.battState.dT_Par "" VALUE 0x0 STANDARD_VALUE_R64 0.0 esdl_ident -1.7976931348623157E+308 1.7976931348623157E+308 /end CHARACTERISTIC
/begin CHARACTERISTIC SOCClasses.SOC.battState.P_SOCCheckStop "" VALUE 0x0 STANDARD_VALUE_R64 0.0 esdl_ident -1.7976931348623157E+308 1.7976931348623157E+308 /end CHARACTERISTIC
/begin MEASUREMENT SOCClasses.SOC.battState.SOC_buffer "" FLOAT64_IEEE esdl_ident 1 100.0 -1.7976931348623157E+308 1.7976931348623157E+308 ECU_ADDRESS 0x0 /end MEASUREMENT
/begin MEASUREMENT SOCClasses.SOC.battState.time_counter "" FLOAT64_IEEE esdl_ident 1 100.0 -1.7976931348623157E+308 1.7976931348623157E+308 ECU_ADDRESS 0x0 /end MEASUREMENT
/begin CHARACTERISTIC SOCClasses.SOC.battState.C_SOC_Coeff "" VALUE 0x0 STANDARD_VALUE_R64 0.0 esdl_ident -1.7976931348623157E+308 1.7976931348623157E+308 /end CHARACTERISTIC
/begin CHARACTERISTIC SOCClasses.ManualCalibration.c_Current "" VALUE 0x0 STANDARD_VALUE_R64 0.0 esdl_ident -1.7976931348623157E+308 1.7976931348623157E+308 /end CHARACTERISTIC
/begin CHARACTERISTIC SOCClasses.ManualCalibration.c_T_ambient "" VALUE 0x0 STANDARD_VALUE_R64 0.0 esdl_ident -1.7976931348623157E+308 1.7976931348623157E+308 /end CHARACTERISTIC
/begin CHARACTERISTIC SOCClasses.ManualCalibration.ManualCalibration_ "" VALUE 0x0 STANDARD_VALUE_U8 0.0 esdl_ident 0 1 BIT_MASK 0x1 /end CHARACTERISTIC
/begin MEASUREMENT Interfaces.akku_messages.voltage "" FLOAT64_IEEE esdl_ident 1 100.0 -1.7976931348623157E+308 1.7976931348623157E+308 ECU_ADDRESS 0x0 /end MEASUREMENT
/begin MEASUREMENT Interfaces.akku_messages.SOC_estimated "" FLOAT64_IEEE esdl_ident 1 100.0 -1.7976931348623157E+308 1.7976931348623157E+308 ECU_ADDRESS 0x0 /end MEASUREMENT
/begin MEASUREMENT Interfaces.akku_messages.SOC_model "" FLOAT64_IEEE esdl_ident 1 100.0 -1.7976931348623157E+308 1.7976931348623157E+308 ECU_ADDRESS 0x0 /end MEASUREMENT
/begin MEASUREMENT Interfaces.akku_messages.T_ambient "" FLOAT64_IEEE esdl_ident 1 100.0 -1.7976931348623157E+308 1.7976931348623157E+308 ECU_ADDRESS 0x0 /end MEASUREMENT
/begin MEASUREMENT Interfaces.akku_messages.T_Cell "" FLOAT64_IEEE esdl_ident 1 100.0 -1.7976931348623157E+308 1.7976931348623157E+308 ECU_ADDRESS 0x0 /end MEASUREMENT
/begin MEASUREMENT Interfaces.akku_messages.current "" FLOAT64_IEEE esdl_ident 1 100.0 -1.7976931348623157E+308 1.7976931348623157E+308 ECU_ADDRESS 0x0 /end MEASUREMENT
/begin MEASUREMENT Interfaces.akku_messages.SOC_low "" UBYTE esdl_ident 1 100.0 0 1 ECU_ADDRESS 0x0 BIT_MASK 0x1 /end MEASUREMENT
/begin MEASUREMENT Interfaces.akku_messages.SOC_symbol "" SLONG esdl_ident 1 100.0 -2147483648 2147483647 ECU_ADDRESS 0x0 /end MEASUREMENT
/begin COMPU_METHOD esdl_SOCClasses_BatteryState1StatemachineStates "" TAB_VERB /* format */ "%12.4" /* unit */ "" /* compu_tab_ref */ COMPU_TAB_REF esdl_SOCClasses_BatteryState1StatemachineStates_vtab /end COMPU_METHOD
/begin COMPU_VTAB esdl_SOCClasses_BatteryState1StatemachineStates_vtab "" TAB_VERB /* number value pairs */ 5 2 "idle" 1 "discharge" 3 "recharge" 4 "SOC_check" 0 "initState" /* default value */ DEFAULT_VALUE "Error" /end COMPU_VTAB
/begin COMPU_METHOD esdl_ident "" RAT_FUNC /* format */ "%12.4" /* unit */ "" /* coeffs */ COEFFS 0 1 0 0 0 1 /end COMPU_METHOD
/begin FUNCTION SOCClasses.BatteryPlantModel ""
 /begin DEF_CHARACTERISTIC SOCClasses.BatteryPlantModel.C_ThermicDampCoeff SOCClasses.BatteryPlantModel.C_Bat SOCClasses.BatteryPlantModel.T0 SOCClasses.BatteryPlantModel.UN SOCClasses.BatteryPlantModel.K1 SOCClasses.BatteryPlantModel.TN SOCClasses.BatteryPlantModel.K2 SOCClasses.BatteryPlantModel.I0 SOCClasses.BatteryPlantModel.P0 SOCClasses.BatteryPlantModel.KN SOCClasses.BatteryPlantModel.U_0 SOCClasses.BatteryPlantModel.R_V_0 SOCClasses.BatteryPlantModel.R_P SOCClasses.BatteryPlantModel.T_SOC_2_RV /end DEF_CHARACTERISTIC
 /begin IN_MEASUREMENT Interfaces.akku_messages.T_ambient Interfaces.akku_messages.current /end IN_MEASUREMENT
 /begin OUT_MEASUREMENT Interfaces.akku_messages.SOC_model Interfaces.akku_messages.T_Cell Interfaces.akku_messages.voltage /end OUT_MEASUREMENT
 /begin LOC_MEASUREMENT SOCClasses.BatteryPlantModel.IV SOCClasses.BatteryPlantModel.PW SOCClasses.BatteryPlantModel.R_V /end LOC_MEASUREMENT
 /begin SUB_FUNCTION SOCClasses.BatteryPlantModel.IntegratorK_instance_T_Cell SOCClasses.BatteryPlantModel.IntegratorK_instance_SOC SOCClasses.BatteryPlantModel.IntegratorKLimited_instance /end SUB_FUNCTION
/end FUNCTION
/begin FUNCTION SOCClasses.BatteryPlantModel.IntegratorK_instance_T_Cell "IntegratorK is a time discrete integrator with gain constant K."
 /begin LOC_MEASUREMENT SOCClasses.BatteryPlantModel.IntegratorK_instance_T_Cell.memory /end LOC_MEASUREMENT
/end FUNCTION
/begin FUNCTION SOCClasses.BatteryPlantModel.IntegratorK_instance_SOC "IntegratorK is a time discrete integrator with gain constant K."
 /begin LOC_MEASUREMENT SOCClasses.BatteryPlantModel.IntegratorK_instance_SOC.memory /end LOC_MEASUREMENT
/end FUNCTION
/begin FUNCTION SOCClasses.BatteryPlantModel.IntegratorKLimited_instance "IntegratorKLimited is a time discrete integrator with gain constant K. Its integrator value can be limited."
 /begin LOC_MEASUREMENT SOCClasses.BatteryPlantModel.IntegratorKLimited_instance.memory /end LOC_MEASUREMENT
/end FUNCTION
/begin FUNCTION SOCClasses.SOC ""
 /begin IN_MEASUREMENT Interfaces.akku_messages.T_Cell Interfaces.akku_messages.current Interfaces.akku_messages.voltage /end IN_MEASUREMENT
 /begin OUT_MEASUREMENT Interfaces.akku_messages.SOC_estimated Interfaces.akku_messages.SOC_low Interfaces.akku_messages.SOC_symbol /end OUT_MEASUREMENT
 /begin SUB_FUNCTION SOCClasses.SOC.accu SOCClasses.SOC.battState /end SUB_FUNCTION
/end FUNCTION
/begin FUNCTION SOCClasses.SOC.accu ""
 /begin DEF_CHARACTERISTIC SOCClasses.SOC.accu.BaseVoltage SOCClasses.SOC.accu.GainVoltage SOCClasses.SOC.accu.GainVoltage_inv SOCClasses.SOC.accu.temp_curve /end DEF_CHARACTERISTIC
/end FUNCTION
/begin FUNCTION SOCClasses.SOC.battState ""
 /begin DEF_CHARACTERISTIC SOCClasses.SOC.battState.P_SOCCheckPeriod SOCClasses.SOC.battState.dT_Par SOCClasses.SOC.battState.P_SOCCheckStop SOCClasses.SOC.battState.C_SOC_Coeff /end DEF_CHARACTERISTIC
 /begin LOC_MEASUREMENT SOCClasses.SOC.battState.SOC_buffer SOCClasses.SOC.battState.SOC_in SOCClasses.SOC.battState.SOC_request SOCClasses.SOC.battState.SOC_value SOCClasses.SOC.battState.current_measure SOCClasses.SOC.battState.sm SOCClasses.SOC.battState.time_counter /end LOC_MEASUREMENT
/end FUNCTION
/begin FUNCTION SOCClasses.ManualCalibration ""
 /begin DEF_CHARACTERISTIC SOCClasses.ManualCalibration.c_Current SOCClasses.ManualCalibration.c_T_ambient SOCClasses.ManualCalibration.ManualCalibration_ /end DEF_CHARACTERISTIC
 /begin OUT_MEASUREMENT Interfaces.akku_messages.T_ambient Interfaces.akku_messages.current /end OUT_MEASUREMENT
/end FUNCTION
/begin RECORD_LAYOUT STANDARD_CURVE_R64R64 /* axis size */ NO_AXIS_PTS_X 1 UWORD /* axis */ AXIS_PTS_X 2 FLOAT64_IEEE INDEX_INCR DIRECT FNC_VALUES 3 FLOAT64_IEEE COLUMN_DIR DIRECT /end RECORD_LAYOUT
/begin RECORD_LAYOUT STANDARD_MAP_R64R64R64 /* x axis size */ NO_AXIS_PTS_X 1 UWORD /* y axis size */ NO_AXIS_PTS_Y 2 UWORD /* x axis */ AXIS_PTS_X 3 FLOAT64_IEEE INDEX_INCR DIRECT /* y axis */ AXIS_PTS_Y 4 FLOAT64_IEEE INDEX_INCR DIRECT FNC_VALUES 5 FLOAT64_IEEE COLUMN_DIR DIRECT /end RECORD_LAYOUT
/begin RECORD_LAYOUT STANDARD_VALUE_R64 FNC_VALUES 1 FLOAT64_IEEE COLUMN_DIR DIRECT /end RECORD_LAYOUT
/begin RECORD_LAYOUT STANDARD_VALUE_U8 FNC_VALUES 1 UBYTE COLUMN_DIR DIRECT /end RECORD_LAYOUT
/begin GROUP Interfaces.akku_messages "" ROOT
 /begin REF_MEASUREMENT Interfaces.akku_messages.SOC_estimated Interfaces.akku_messages.SOC_low Interfaces.akku_messages.SOC_model Interfaces.akku_messages.SOC_symbol Interfaces.akku_messages.T_Cell Interfaces.akku_messages.T_ambient Interfaces.akku_messages.current Interfaces.akku_messages.voltage /end REF_MEASUREMENT
/end GROUP
/begin GROUP SOCClasses.BatteryPlantModel "" ROOT
 /begin REF_CHARACTERISTIC SOCClasses.BatteryPlantModel.C_ThermicDampCoeff SOCClasses.BatteryPlantModel.C_Bat SOCClasses.BatteryPlantModel.T0 SOCClasses.BatteryPlantModel.UN SOCClasses.BatteryPlantModel.K1 SOCClasses.BatteryPlantModel.TN SOCClasses.BatteryPlantModel.K2 SOCClasses.BatteryPlantModel.I0 SOCClasses.BatteryPlantModel.P0 SOCClasses.BatteryPlantModel.KN SOCClasses.BatteryPlantModel.U_0 SOCClasses.BatteryPlantModel.R_V_0 SOCClasses.BatteryPlantModel.R_P SOCClasses.BatteryPlantModel.T_SOC_2_RV /end REF_CHARACTERISTIC
 /begin REF_MEASUREMENT SOCClasses.BatteryPlantModel.IV SOCClasses.BatteryPlantModel.PW SOCClasses.BatteryPlantModel.R_V /end REF_MEASUREMENT
 /begin SUB_GROUP SOCClasses.BatteryPlantModel.IntegratorK_instance_T_Cell SOCClasses.BatteryPlantModel.IntegratorK_instance_SOC SOCClasses.BatteryPlantModel.IntegratorKLimited_instance /end SUB_GROUP
/end GROUP
/begin GROUP SOCClasses.BatteryPlantModel.IntegratorKLimited_instance "IntegratorKLimited is a time discrete integrator with gain constant K. Its integrator value can be limited."
 /begin REF_MEASUREMENT SOCClasses.BatteryPlantModel.IntegratorKLimited_instance.memory /end REF_MEASUREMENT
/end GROUP
/begin GROUP SOCClasses.BatteryPlantModel.IntegratorK_instance_SOC "IntegratorK is a time discrete integrator with gain constant K."
 /begin REF_MEASUREMENT SOCClasses.BatteryPlantModel.IntegratorK_instance_SOC.memory /end REF_MEASUREMENT
/end GROUP
/begin GROUP SOCClasses.BatteryPlantModel.IntegratorK_instance_T_Cell "IntegratorK is a time discrete integrator with gain constant K."
 /begin REF_MEASUREMENT SOCClasses.BatteryPlantModel.IntegratorK_instance_T_Cell.memory /end REF_MEASUREMENT
/end GROUP
/begin GROUP SOCClasses.ManualCalibration "" ROOT
 /begin REF_CHARACTERISTIC SOCClasses.ManualCalibration.c_Current SOCClasses.ManualCalibration.c_T_ambient SOCClasses.ManualCalibration.ManualCalibration_ /end REF_CHARACTERISTIC
/end GROUP
/begin GROUP SOCClasses.SOC "" ROOT /begin SUB_GROUP SOCClasses.SOC.accu SOCClasses.SOC.battState /end SUB_GROUP /end GROUP
/begin GROUP SOCClasses.SOC.accu ""
 /begin REF_CHARACTERISTIC SOCClasses.SOC.accu.BaseVoltage SOCClasses.SOC.accu.GainVoltage SOCClasses.SOC.accu.GainVoltage_inv SOCClasses.SOC.accu.temp_curve /end REF_CHARACTERISTIC
/end GROUP
/begin GROUP SOCClasses.SOC.battState ""
 /begin REF_CHARACTERISTIC SOCClasses.SOC.battState.P_SOCCheckPeriod SOCClasses.SOC.battState.dT_Par SOCClasses.SOC.battState.P_SOCCheckStop SOCClasses.SOC.battState.C_SOC_Coeff /end REF_CHARACTERISTIC
 /begin REF_MEASUREMENT SOCClasses.SOC.battState.SOC_buffer SOCClasses.SOC.battState.SOC_in SOCClasses.SOC.battState.SOC_request SOCClasses.SOC.battState.SOC_value SOCClasses.SOC.battState.current_measure SOCClasses.SOC.battState.sm SOCClasses.SOC.battState.time_counter /end REF_MEASUREMENT
/end GROUP
/end MODULE
/end PROJECT
