ASAP2_VERSION 1 41
/begin PROJECT Simulation_PC "Generated by ETAS from Project Simulation_PC"
/begin HEADER "" VERSION "000" PROJECT_NO ASD /end HEADER
/begin MODULE Simulation_PC "Generated by ETAS ASCET7 from Project: Simulation_PC"
/begin IF_DATA E_TARGET
 /begin SOURCE "Task0" 3 /* period */ 10 QP_BLOB 1 /end SOURCE
 /begin TP_BLOB /* programm id */ 888142619 /* target id */ 7 0 2 0 /end TP_BLOB
/end IF_DATA
/begin MOD_PAR "" VERSION "000" ADDR_EPK 0x0 EPK "" SUPPLIER "ETAS GmbH" CUSTOMER "xxx" CUSTOMER_NO "000" USER "xxx" PHONE_NO "000" ECU "PC" CPU_TYPE "PCx86" NO_OF_INTERFACES 1 /end MOD_PAR
/begin MOD_COMMON "Common definitions" BYTE_ORDER MSB_LAST ALIGNMENT_BYTE 1 ALIGNMENT_WORD 2 ALIGNMENT_LONG 4 ALIGNMENT_FLOAT32_IEEE 4 ALIGNMENT_FLOAT64_IEEE 8 /end MOD_COMMON
/begin MEASUREMENT control.RemoteCommandsMain.Balance2WD.enginesOn "" SLONG esdl_ident 1 100.0 -2147483648 2147483647 ECU_ADDRESS 0x0 /end MEASUREMENT
/begin MEASUREMENT control.RemoteCommandsMain.Balance2WD.frontDistance "" FLOAT32_IEEE esdl_ident 1 100.0 -3.4028234663852886E+38 3.4028234663852886E+38 ECU_ADDRESS 0x0 /end MEASUREMENT
/begin MEASUREMENT control.RemoteCommandsMain.rc.sm "" UBYTE esdl_control_RemoteCommandsStatemachineStates 1 100.0 0 18 ECU_ADDRESS 0x0 /end MEASUREMENT
/begin MEASUREMENT control.RemoteCommandsMain.rc.mode "" UBYTE esdl_control_EModes 1 100.0 0 20 ECU_ADDRESS 0x0 /end MEASUREMENT
/begin MEASUREMENT control.RemoteCommandsMain.rc.counter "" SLONG esdl_ident 1 100.0 -2147483648 2147483647 ECU_ADDRESS 0x0 /end MEASUREMENT
/begin MEASUREMENT control.RemoteCommandsMain.rc.localTimer.timeCounter "" FLOAT32_IEEE esdl_ident 1 100.0 -3.4028234663852886E+38 3.4028234663852886E+38 ECU_ADDRESS 0x0 /end MEASUREMENT
/begin CHARACTERISTIC simulation.Stimulator.mode "" VALUE /* ecu address */ 0x0 /* record layout */ STANDARD_VALUE_U8 /* max diff value */ 0.0 esdl_control_EModes 0 20 /end CHARACTERISTIC
/begin CHARACTERISTIC simulation.Stimulator.microseconds "" VALUE /* ecu address */ 0x0 /* record layout */ STANDARD_VALUE_S32 /* max diff value */ 0.0 esdl_ident -2147483648 2147483647 /end CHARACTERISTIC
/begin MEASUREMENT interfaces.IBalance2WD.PWM1 "" FLOAT32_IEEE esdl_ident 1 100.0 -3.4028234663852886E+38 3.4028234663852886E+38 ECU_ADDRESS 0x0 /end MEASUREMENT
/begin MEASUREMENT interfaces.IBalance2WD.PWM2 "" FLOAT32_IEEE esdl_ident 1 100.0 -3.4028234663852886E+38 3.4028234663852886E+38 ECU_ADDRESS 0x0 /end MEASUREMENT
/begin MEASUREMENT interfaces.IBalance2WD.ServoAngle "" SLONG esdl_ident 1 100.0 -2147483648 2147483647 ECU_ADDRESS 0x0 /end MEASUREMENT
/begin MEASUREMENT interfaces.IBalance2WD.AngleOutput "" FLOAT32_IEEE esdl_ident 1 100.0 -3.4028234663852886E+38 3.4028234663852886E+38 ECU_ADDRESS 0x0 /end MEASUREMENT
/begin MEASUREMENT interfaces.IBalance2WD.SpeedOutput "" FLOAT32_IEEE esdl_ident 1 100.0 -3.4028234663852886E+38 3.4028234663852886E+38 ECU_ADDRESS 0x0 /end MEASUREMENT
/begin MEASUREMENT interfaces.IBalance2WD.TurnOutput "" FLOAT32_IEEE esdl_ident 1 100.0 -3.4028234663852886E+38 3.4028234663852886E+38 ECU_ADDRESS 0x0 /end MEASUREMENT
/begin MEASUREMENT interfaces.IBalance2WD.PulseLeft "" SLONG esdl_ident 1 100.0 -2147483648 2147483647 ECU_ADDRESS 0x0 /end MEASUREMENT
/begin MEASUREMENT interfaces.IBalance2WD.PulseRight "" SLONG esdl_ident 1 100.0 -2147483648 2147483647 ECU_ADDRESS 0x0 /end MEASUREMENT
/begin MEASUREMENT interfaces.IBalance2WD.LEDColor "" SLONG esdl_ident 1 100.0 -2147483648 2147483647 ECU_ADDRESS 0x0 /end MEASUREMENT
/begin MEASUREMENT interfaces.IBalance2WD.CurrentAngle "" FLOAT32_IEEE esdl_ident 1 100.0 -3.4028234663852886E+38 3.4028234663852886E+38 ECU_ADDRESS 0x0 /end MEASUREMENT
/begin MEASUREMENT interfaces.IBalance2WD.TurnLeftRightFlag "" SLONG esdl_ident 1 100.0 -2147483648 2147483647 ECU_ADDRESS 0x0 /end MEASUREMENT
/begin MEASUREMENT interfaces.IBalance2WD.CountLeft "" SLONG esdl_ident 1 100.0 -2147483648 2147483647 ECU_ADDRESS 0x0 /end MEASUREMENT
/begin MEASUREMENT interfaces.IBalance2WD.CountRight "" SLONG esdl_ident 1 100.0 -2147483648 2147483647 ECU_ADDRESS 0x0 /end MEASUREMENT
/begin MEASUREMENT interfaces.IBalance2WD.UltraSonicSignalRuntimeInMicroSeconds "" SLONG esdl_ident 1 100.0 -2147483648 2147483647 ECU_ADDRESS 0x0 /end MEASUREMENT
/begin MEASUREMENT interfaces.IBalance2WD.AccelerationX "" SLONG esdl_ident 1 100.0 -2147483648 2147483647 ECU_ADDRESS 0x0 /end MEASUREMENT
/begin MEASUREMENT interfaces.IBalance2WD.AccelerationY "" SLONG esdl_ident 1 100.0 -2147483648 2147483647 ECU_ADDRESS 0x0 /end MEASUREMENT
/begin MEASUREMENT interfaces.IBalance2WD.AccelerationZ "" SLONG esdl_ident 1 100.0 -2147483648 2147483647 ECU_ADDRESS 0x0 /end MEASUREMENT
/begin MEASUREMENT interfaces.IBalance2WD.GyroX "" SLONG esdl_ident 1 100.0 -2147483648 2147483647 ECU_ADDRESS 0x0 /end MEASUREMENT
/begin MEASUREMENT interfaces.IBalance2WD.GyroY "" SLONG esdl_ident 1 100.0 -2147483648 2147483647 ECU_ADDRESS 0x0 /end MEASUREMENT
/begin MEASUREMENT interfaces.IBalance2WD.GyroZ "" SLONG esdl_ident 1 100.0 -2147483648 2147483647 ECU_ADDRESS 0x0 /end MEASUREMENT
/begin MEASUREMENT interfaces.IBalance2WD.BuzzerOn "" SLONG esdl_ident 1 100.0 -2147483648 2147483647 ECU_ADDRESS 0x0 /end MEASUREMENT
/begin MEASUREMENT interfaces.IParameters.KpAngle "" FLOAT32_IEEE esdl_ident 1 100.0 -3.4028234663852886E+38 3.4028234663852886E+38 ECU_ADDRESS 0x0 /end MEASUREMENT
/begin MEASUREMENT interfaces.IParameters.KiAngle "" FLOAT32_IEEE esdl_ident 1 100.0 -3.4028234663852886E+38 3.4028234663852886E+38 ECU_ADDRESS 0x0 /end MEASUREMENT
/begin MEASUREMENT interfaces.IParameters.KpSpeed "" FLOAT32_IEEE esdl_ident 1 100.0 -3.4028234663852886E+38 3.4028234663852886E+38 ECU_ADDRESS 0x0 /end MEASUREMENT
/begin MEASUREMENT interfaces.IParameters.KiSpeed "" FLOAT32_IEEE esdl_ident 1 100.0 -3.4028234663852886E+38 3.4028234663852886E+38 ECU_ADDRESS 0x0 /end MEASUREMENT
/begin MEASUREMENT interfaces.IParameters.KpTurn "" FLOAT32_IEEE esdl_ident 1 100.0 -3.4028234663852886E+38 3.4028234663852886E+38 ECU_ADDRESS 0x0 /end MEASUREMENT
/begin MEASUREMENT interfaces.IParameters.TargetAngle "" FLOAT32_IEEE esdl_ident 1 100.0 -3.4028234663852886E+38 3.4028234663852886E+38 ECU_ADDRESS 0x0 /end MEASUREMENT
/begin MEASUREMENT interfaces.IParameters.TargetSpeed "" FLOAT32_IEEE esdl_ident 1 100.0 -3.4028234663852886E+38 3.4028234663852886E+38 ECU_ADDRESS 0x0 /end MEASUREMENT
/begin MEASUREMENT interfaces.IRemoteCommands.Mode "" UBYTE esdl_control_EModes 1 100.0 0 20 ECU_ADDRESS 0x0 /end MEASUREMENT
/begin COMPU_METHOD esdl_control_EModes "" TAB_VERB "%12.4" "" /* compu_tab_ref */ COMPU_TAB_REF esdl_control_EModes_vtab /end COMPU_METHOD
/begin COMPU_VTAB esdl_control_EModes_vtab "" TAB_VERB /* number value pairs */ 21 0 "STOP_BALANCING" 1 "GO_FORWARD" 2 "TURN_RIGHT" 3 "TURN_LEFT" 4 "GO_BACKWARD" 5 "STOP" 6 "BUZZER_ON" 7 "BUZZER_OFF" 8 "STOP_TURNING" 9 "INC_KPSPEED" 10 "DEC_KPSPEED" 11 "INC_KPANGLE" 12 "DEC_KPANGLE" 13 "INC_KISPEED" 14 "DEC_KISPEED" 15 "INC_ZEROANGLE" 16 "DEC_ZEROANGLE" 17 "OBSTACLE_AVOIDANCE" 18 "OPENLAB_MODE" 19 "INC_KIANGLE" 20 "DEC_KIANGLE" /* default value */ DEFAULT_VALUE "Error" /end COMPU_VTAB
/begin COMPU_METHOD esdl_control_RemoteCommandsStatemachineStates "" TAB_VERB "%12.4" "" /* compu_tab_ref */ COMPU_TAB_REF esdl_control_RemoteCommandsStatemachineStates_vtab /end COMPU_METHOD
/begin COMPU_VTAB esdl_control_RemoteCommandsStatemachineStates_vtab "" TAB_VERB /* number value pairs */ 19 12 "StopBalancing" 4 "GoForward" 3 "GoBackward" 14 "TurnLeft" 15 "TurnRight" 7 "Parked" 9 "StartBalancing" 16 "AvoidObstacles" 17 "ManualDrive" 0 "Dispatch" 18 "OpenLab" 13 "StopTurning" 11 "Stop" 8 "Stabilizing" 5 "MovingForward" 2 "FarObstacleDetected" 6 "NearObstacleDetected" 10 "Starting" 1 "Driving" /* default value */ DEFAULT_VALUE "Error" /end COMPU_VTAB
/begin COMPU_METHOD esdl_ident "" RAT_FUNC "%12.4" "" /* coeffs */ COEFFS 0 1 0 0 0 1 /end COMPU_METHOD
/begin FUNCTION control.RemoteCommandsMain.Balance2WD ""
 /begin IN_MEASUREMENT interfaces.IBalance2WD.AngleOutput interfaces.IBalance2WD.CurrentAngle interfaces.IBalance2WD.SpeedOutput interfaces.IBalance2WD.TurnOutput interfaces.IBalance2WD.UltraSonicSignalRuntimeInMicroSeconds /end IN_MEASUREMENT
 /begin OUT_MEASUREMENT interfaces.IBalance2WD.BuzzerOn interfaces.IBalance2WD.CountLeft interfaces.IBalance2WD.CountRight interfaces.IBalance2WD.LEDColor interfaces.IBalance2WD.PWM1 interfaces.IBalance2WD.PWM2 interfaces.IBalance2WD.PulseLeft interfaces.IBalance2WD.PulseRight interfaces.IBalance2WD.ServoAngle interfaces.IBalance2WD.TurnLeftRightFlag interfaces.IParameters.TargetSpeed /end OUT_MEASUREMENT
 /begin LOC_MEASUREMENT control.RemoteCommandsMain.Balance2WD.enginesOn control.RemoteCommandsMain.Balance2WD.frontDistance /end LOC_MEASUREMENT
/end FUNCTION
/begin FUNCTION control.RemoteCommandsMain "" /begin IN_MEASUREMENT interfaces.IRemoteCommands.Mode /end IN_MEASUREMENT /begin SUB_FUNCTION control.RemoteCommandsMain.rc /end SUB_FUNCTION /end FUNCTION
/begin FUNCTION control.RemoteCommandsMain.rc ""
 /begin LOC_MEASUREMENT control.RemoteCommandsMain.rc.counter control.RemoteCommandsMain.rc.mode control.RemoteCommandsMain.rc.sm /end LOC_MEASUREMENT
 /begin SUB_FUNCTION control.RemoteCommandsMain.rc.localTimer /end SUB_FUNCTION
/end FUNCTION
/begin FUNCTION control.RemoteCommandsMain.rc.localTimer "Timer decrements the time counter by dT and signals when the time counter has reached zero. It is not retriggerable." /begin LOC_MEASUREMENT control.RemoteCommandsMain.rc.localTimer.timeCounter /end LOC_MEASUREMENT /end FUNCTION
/begin FUNCTION simulation.Stimulator ""
 /begin DEF_CHARACTERISTIC simulation.Stimulator.mode simulation.Stimulator.microseconds /end DEF_CHARACTERISTIC
 /begin OUT_MEASUREMENT interfaces.IBalance2WD.UltraSonicSignalRuntimeInMicroSeconds interfaces.IRemoteCommands.Mode /end OUT_MEASUREMENT
/end FUNCTION
/begin RECORD_LAYOUT STANDARD_VALUE_S32 /* value */ FNC_VALUES 1 SLONG COLUMN_DIR DIRECT /end RECORD_LAYOUT
/begin RECORD_LAYOUT STANDARD_VALUE_U8 /* value */ FNC_VALUES 1 UBYTE COLUMN_DIR DIRECT /end RECORD_LAYOUT
/begin GROUP control.RemoteCommandsMain "" ROOT /begin SUB_GROUP control.RemoteCommandsMain.rc /end SUB_GROUP /end GROUP
/begin GROUP control.RemoteCommandsMain.Balance2WD "" ROOT
 /begin REF_MEASUREMENT control.RemoteCommandsMain.Balance2WD.enginesOn control.RemoteCommandsMain.Balance2WD.frontDistance /end REF_MEASUREMENT
/end GROUP
/begin GROUP control.RemoteCommandsMain.rc ""
 /begin REF_MEASUREMENT control.RemoteCommandsMain.rc.counter control.RemoteCommandsMain.rc.mode control.RemoteCommandsMain.rc.sm /end REF_MEASUREMENT
 /begin SUB_GROUP control.RemoteCommandsMain.rc.localTimer /end SUB_GROUP
/end GROUP
/begin GROUP control.RemoteCommandsMain.rc.localTimer "Timer decrements the time counter by dT and signals when the time counter has reached zero. It is not retriggerable." /begin REF_MEASUREMENT control.RemoteCommandsMain.rc.localTimer.timeCounter /end REF_MEASUREMENT /end GROUP
/begin GROUP interfaces.IBalance2WD "" ROOT
 /begin REF_MEASUREMENT interfaces.IBalance2WD.AccelerationX interfaces.IBalance2WD.AccelerationY interfaces.IBalance2WD.AccelerationZ interfaces.IBalance2WD.AngleOutput interfaces.IBalance2WD.BuzzerOn interfaces.IBalance2WD.CountLeft interfaces.IBalance2WD.CountRight interfaces.IBalance2WD.CurrentAngle interfaces.IBalance2WD.GyroX interfaces.IBalance2WD.GyroY interfaces.IBalance2WD.GyroZ interfaces.IBalance2WD.LEDColor interfaces.IBalance2WD.PWM1 interfaces.IBalance2WD.PWM2 interfaces.IBalance2WD.PulseLeft interfaces.IBalance2WD.PulseRight interfaces.IBalance2WD.ServoAngle interfaces.IBalance2WD.SpeedOutput interfaces.IBalance2WD.TurnLeftRightFlag interfaces.IBalance2WD.TurnOutput interfaces.IBalance2WD.UltraSonicSignalRuntimeInMicroSeconds /end REF_MEASUREMENT
/end GROUP
/begin GROUP interfaces.IParameters "" ROOT
 /begin REF_MEASUREMENT interfaces.IParameters.KiAngle interfaces.IParameters.KiSpeed interfaces.IParameters.KpAngle interfaces.IParameters.KpSpeed interfaces.IParameters.KpTurn interfaces.IParameters.TargetAngle interfaces.IParameters.TargetSpeed /end REF_MEASUREMENT
/end GROUP
/begin GROUP interfaces.IRemoteCommands "" ROOT /begin REF_MEASUREMENT interfaces.IRemoteCommands.Mode /end REF_MEASUREMENT /end GROUP
/begin GROUP simulation.Stimulator "" ROOT
 /begin REF_CHARACTERISTIC simulation.Stimulator.mode simulation.Stimulator.microseconds /end REF_CHARACTERISTIC
/end GROUP
/end MODULE
/end PROJECT
